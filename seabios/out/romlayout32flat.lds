
/* DO NOT EDIT!  This is an autogenerated file.  See scripts/layoutrom.py. */
OUTPUT_FORMAT("elf32-i386")
OUTPUT_ARCH("i386")
SECTIONS
{
TPM_interface_shutdown = 0xeb9c0 ;
sercon_attr = 0xeb9f8 ;
BootSequence = 0xeb9d8 ;
sercon_col_last = 0xeb9fb ;
TimerLast = 0xeb9e0 ;
tpm_state = 0xeb9c4 ;
emulated_drive_gf = 0xeba14 ;
sercon_port = 0xeba00 ;
StackPos = 0xeba3c ;
CDEmu = 0xeba18 ;
Century = 0xeb9e4 ;
sercon_split = 0xeb9fe ;
ExtraStack = 0xeba40 ;
sercon_attr_last = 0xeb9fc ;
DefaultDPTE = 0xeba2c ;
sercon_enable = 0xeb9fd ;
sercon_row_last = 0xeb9fa ;
rx_buf = 0xeb9e8 ;
Ps2ctr = 0xeb9dd ;
rx_bytes = 0xeb9e5 ;
Call16Data = 0xec244 ;
sercon_char = 0xeb9f9 ;
CDRom_locks = 0xeba04 ;
TPM_working = 0xeb9c1 ;
FloppyDOR = 0xeb9dc ;
reset_vector = 0xffff0 ;
transition16big = 0xfcb3c ;
transition16 = 0xfcb27 ;
_cfunc16_call16_helper = 0xf8bd5 ;
transition32_nmi_off = 0xfcaf1 ;
_cfunc16_check_irqs = 0xf9324 ;
_cfunc16_wait_irq = 0xfb24d ;
entry_smp = 0xfcc02 ;
_cfunc16__farcall16 = 0xf8c80 ;
entry_19_official = 0xfe6f2 ;
irq_trampoline_0x13 = 0xfe82a ;
entry_10 = 0xff065 ;
irq_trampoline_0x10 = 0xffa69 ;
irq_trampoline_0x18 = 0xfff50 ;
irq_trampoline_0x19 = 0xff0a0 ;
entry_iret_official = 0xfff53 ;
entry_hwpic1 = 0xfcf62 ;
entry_hwpic2 = 0xfcf6b ;
entry_02 = 0xfe2c3 ;
entry_05 = 0xfff54 ;
entry_11 = 0xff84d ;
entry_12 = 0xff841 ;
entry_13_official = 0xfe3fe ;
entry_14 = 0xfe739 ;
entry_15_official = 0xff859 ;
entry_16 = 0xfe82e ;
entry_17 = 0xfefd2 ;
entry_18 = 0xfcf87 ;
entry_1a_official = 0xffe6e ;
entry_40 = 0xfec59 ;
entry_bios32 = 0xff046 ;
entry_pmm = 0xfcc47 ;
entry_pnp_real = 0xfcca9 ;
entry_pnp_prot = 0xfcca5 ;
entry_75 = 0xfcf59 ;
entry_08 = 0xffea5 ;
entry_sercon = 0xfcdc8 ;
entry_09 = 0xfe987 ;
entry_74 = 0xfcf50 ;
entry_0e = 0xfef57 ;
entry_76 = 0xfcf47 ;

    _reloc_min_align = 0x20 ;
    zonefseg_start = 0xf5b60 ;
    zonefseg_end = 0xf6360 ;
    zonelow_base = 0xdc800 ;
    final_varlow_start = 0xeb9c0 ;
    final_readonly_start = 0xec260 ;
    varlow_start = 0xdd100 ;
    varlow_end = 0xdd9a0 ;
    code32init_start = 0xdd9a0 ;
    code32init_end = 0xec260 ;

    code32flat_start = 0xdbec0 ;
    .text code32flat_start : {

        _reloc_abs_start = ABSOLUTE(.) ;
LONG(0xddb95 - code32init_start)
LONG(0xddbb9 - code32init_start)
LONG(0xddbc1 - code32init_start)
LONG(0xddbef - code32init_start)
LONG(0xddbf7 - code32init_start)
LONG(0xddc0f - code32init_start)
LONG(0xddcaa - code32init_start)
LONG(0xddd3e - code32init_start)
LONG(0xddd47 - code32init_start)
LONG(0xddd7a - code32init_start)
LONG(0xddd83 - code32init_start)
LONG(0xddd8f - code32init_start)
LONG(0xdde6f - code32init_start)
LONG(0xdde87 - code32init_start)
LONG(0xddebf - code32init_start)
LONG(0xddeed - code32init_start)
LONG(0xddef9 - code32init_start)
LONG(0xddf33 - code32init_start)
LONG(0xddf40 - code32init_start)
LONG(0xddf53 - code32init_start)
LONG(0xddf5d - code32init_start)
LONG(0xddf67 - code32init_start)
LONG(0xddf6b - code32init_start)
LONG(0xde09e - code32init_start)
LONG(0xde0a6 - code32init_start)
LONG(0xde769 - code32init_start)
LONG(0xde8f2 - code32init_start)
LONG(0xdea3d - code32init_start)
LONG(0xdeae3 - code32init_start)
LONG(0xdef4b - code32init_start)
LONG(0xdef66 - code32init_start)
LONG(0xdefb2 - code32init_start)
LONG(0xdefe7 - code32init_start)
LONG(0xdf025 - code32init_start)
LONG(0xdf075 - code32init_start)
LONG(0xdf07c - code32init_start)
LONG(0xdf0ed - code32init_start)
LONG(0xdf16f - code32init_start)
LONG(0xdf176 - code32init_start)
LONG(0xdf1b2 - code32init_start)
LONG(0xdf225 - code32init_start)
LONG(0xdf23f - code32init_start)
LONG(0xdf24e - code32init_start)
LONG(0xdf335 - code32init_start)
LONG(0xdf451 - code32init_start)
LONG(0xdf4d3 - code32init_start)
LONG(0xdf518 - code32init_start)
LONG(0xdf526 - code32init_start)
LONG(0xdf5b7 - code32init_start)
LONG(0xdf63f - code32init_start)
LONG(0xdf649 - code32init_start)
LONG(0xdf6f3 - code32init_start)
LONG(0xdf6f9 - code32init_start)
LONG(0xdf723 - code32init_start)
LONG(0xdf735 - code32init_start)
LONG(0xdf73a - code32init_start)
LONG(0xdf88f - code32init_start)
LONG(0xdf8cd - code32init_start)
LONG(0xdfa52 - code32init_start)
LONG(0xdfaeb - code32init_start)
LONG(0xdfd24 - code32init_start)
LONG(0xdfec6 - code32init_start)
LONG(0xe0628 - code32init_start)
LONG(0xe07ca - code32init_start)
LONG(0xe0abf - code32init_start)
LONG(0xe0ade - code32init_start)
LONG(0xe0b00 - code32init_start)
LONG(0xe0b13 - code32init_start)
LONG(0xe0b6c - code32init_start)
LONG(0xe0bb8 - code32init_start)
LONG(0xe0bcd - code32init_start)
LONG(0xe0bd5 - code32init_start)
LONG(0xe0c1c - code32init_start)
LONG(0xe0ccc - code32init_start)
LONG(0xe0cda - code32init_start)
LONG(0xe0cfe - code32init_start)
LONG(0xe0d1f - code32init_start)
LONG(0xe0d6d - code32init_start)
LONG(0xe0d9c - code32init_start)
LONG(0xe0db2 - code32init_start)
LONG(0xe0dfd - code32init_start)
LONG(0xe0e6d - code32init_start)
LONG(0xe0fc6 - code32init_start)
LONG(0xe13a2 - code32init_start)
LONG(0xe13da - code32init_start)
LONG(0xe13e2 - code32init_start)
LONG(0xe1434 - code32init_start)
LONG(0xe149f - code32init_start)
LONG(0xe14d8 - code32init_start)
LONG(0xe1635 - code32init_start)
LONG(0xe1650 - code32init_start)
LONG(0xe1656 - code32init_start)
LONG(0xe1661 - code32init_start)
LONG(0xe166d - code32init_start)
LONG(0xe1677 - code32init_start)
LONG(0xe1688 - code32init_start)
LONG(0xe1690 - code32init_start)
LONG(0xe1696 - code32init_start)
LONG(0xe169e - code32init_start)
LONG(0xe16f8 - code32init_start)
LONG(0xe16fd - code32init_start)
LONG(0xe1703 - code32init_start)
LONG(0xe170c - code32init_start)
LONG(0xe1745 - code32init_start)
LONG(0xe1778 - code32init_start)
LONG(0xe17ae - code32init_start)
LONG(0xe1cbc - code32init_start)
LONG(0xe1cc2 - code32init_start)
LONG(0xe1ccf - code32init_start)
LONG(0xe1d44 - code32init_start)
LONG(0xe1df3 - code32init_start)
LONG(0xe1e32 - code32init_start)
LONG(0xe1e4c - code32init_start)
LONG(0xe1e5d - code32init_start)
LONG(0xe1ea3 - code32init_start)
LONG(0xe1ea9 - code32init_start)
LONG(0xe1efd - code32init_start)
LONG(0xe1f03 - code32init_start)
LONG(0xe1f16 - code32init_start)
LONG(0xe1f7b - code32init_start)
LONG(0xe1f85 - code32init_start)
LONG(0xe1fef - code32init_start)
LONG(0xe1ff5 - code32init_start)
LONG(0xe2012 - code32init_start)
LONG(0xe2018 - code32init_start)
LONG(0xe2081 - code32init_start)
LONG(0xe21e2 - code32init_start)
LONG(0xe21e8 - code32init_start)
LONG(0xe220a - code32init_start)
LONG(0xe2210 - code32init_start)
LONG(0xe22ac - code32init_start)
LONG(0xe22c4 - code32init_start)
LONG(0xe23cb - code32init_start)
LONG(0xe244e - code32init_start)
LONG(0xe24ac - code32init_start)
LONG(0xe24f3 - code32init_start)
LONG(0xe250c - code32init_start)
LONG(0xe2514 - code32init_start)
LONG(0xe255f - code32init_start)
LONG(0xe2690 - code32init_start)
LONG(0xe26a2 - code32init_start)
LONG(0xe2733 - code32init_start)
LONG(0xe2762 - code32init_start)
LONG(0xe27c1 - code32init_start)
LONG(0xe27fc - code32init_start)
LONG(0xe28b0 - code32init_start)
LONG(0xe2bbf - code32init_start)
LONG(0xe2f27 - code32init_start)
LONG(0xe3120 - code32init_start)
LONG(0xe314c - code32init_start)
LONG(0xe3228 - code32init_start)
LONG(0xe33f8 - code32init_start)
LONG(0xe3414 - code32init_start)
LONG(0xe3471 - code32init_start)
LONG(0xe349c - code32init_start)
LONG(0xe34d3 - code32init_start)
LONG(0xe34fb - code32init_start)
LONG(0xe3523 - code32init_start)
LONG(0xe3555 - code32init_start)
LONG(0xe3794 - code32init_start)
LONG(0xe37bf - code32init_start)
LONG(0xe37f8 - code32init_start)
LONG(0xe3812 - code32init_start)
LONG(0xe385a - code32init_start)
LONG(0xe387a - code32init_start)
LONG(0xe3910 - code32init_start)
LONG(0xe3bab - code32init_start)
LONG(0xe3c44 - code32init_start)
LONG(0xe3c4e - code32init_start)
LONG(0xe3c58 - code32init_start)
LONG(0xe3c5c - code32init_start)
LONG(0xe3c7e - code32init_start)
LONG(0xe3c84 - code32init_start)
LONG(0xe3c9c - code32init_start)
LONG(0xe3cac - code32init_start)
LONG(0xe3cd5 - code32init_start)
LONG(0xe3dbb - code32init_start)
LONG(0xe3e40 - code32init_start)
LONG(0xe3e52 - code32init_start)
LONG(0xe3f8d - code32init_start)
LONG(0xe3fa1 - code32init_start)
LONG(0xe4197 - code32init_start)
LONG(0xe41aa - code32init_start)
LONG(0xe41c6 - code32init_start)
LONG(0xe4231 - code32init_start)
LONG(0xe43e6 - code32init_start)
LONG(0xe44e1 - code32init_start)
LONG(0xe4583 - code32init_start)
LONG(0xe4599 - code32init_start)
LONG(0xe45aa - code32init_start)
LONG(0xe4659 - code32init_start)
LONG(0xe477b - code32init_start)
LONG(0xe4780 - code32init_start)
LONG(0xe47d0 - code32init_start)
LONG(0xe4858 - code32init_start)
LONG(0xe48a9 - code32init_start)
LONG(0xe48c0 - code32init_start)
LONG(0xe492b - code32init_start)
LONG(0xe4966 - code32init_start)
LONG(0xe497b - code32init_start)
LONG(0xe49ab - code32init_start)
LONG(0xe49ec - code32init_start)
LONG(0xe49f8 - code32init_start)
LONG(0xe4a21 - code32init_start)
LONG(0xe4ad8 - code32init_start)
LONG(0xe4b25 - code32init_start)
LONG(0xe4b91 - code32init_start)
LONG(0xe4c42 - code32init_start)
LONG(0xe4c48 - code32init_start)
LONG(0xe4c58 - code32init_start)
LONG(0xe4c7a - code32init_start)
LONG(0xe4d09 - code32init_start)
LONG(0xe4d17 - code32init_start)
LONG(0xe4d22 - code32init_start)
LONG(0xe4d33 - code32init_start)
LONG(0xe4d43 - code32init_start)
LONG(0xe4d54 - code32init_start)
LONG(0xe4d83 - code32init_start)
LONG(0xe4ea9 - code32init_start)
LONG(0xe4f30 - code32init_start)
LONG(0xe5143 - code32init_start)
LONG(0xe5262 - code32init_start)
LONG(0xe532f - code32init_start)
LONG(0xe538e - code32init_start)
LONG(0xe53c0 - code32init_start)
LONG(0xe5968 - code32init_start)
LONG(0xe5970 - code32init_start)
LONG(0xe5976 - code32init_start)
LONG(0xe5ad2 - code32init_start)
LONG(0xe5b17 - code32init_start)
LONG(0xe5b1d - code32init_start)
LONG(0xe5b44 - code32init_start)
LONG(0xe5b4a - code32init_start)
LONG(0xe5bb8 - code32init_start)
LONG(0xe5c04 - code32init_start)
LONG(0xe5c0a - code32init_start)
LONG(0xe5c63 - code32init_start)
LONG(0xe5d65 - code32init_start)
LONG(0xe5ddb - code32init_start)
LONG(0xe5edd - code32init_start)
LONG(0xe5f07 - code32init_start)
LONG(0xe5f91 - code32init_start)
LONG(0xe5f9f - code32init_start)
LONG(0xe5fed - code32init_start)
LONG(0xe602e - code32init_start)
LONG(0xe60a9 - code32init_start)
LONG(0xe612f - code32init_start)
LONG(0xe6231 - code32init_start)
LONG(0xe6238 - code32init_start)
LONG(0xe627d - code32init_start)
LONG(0xe62a6 - code32init_start)
LONG(0xe62ad - code32init_start)
LONG(0xe62e7 - code32init_start)
LONG(0xe6497 - code32init_start)
LONG(0xe64dc - code32init_start)
LONG(0xe64e3 - code32init_start)
LONG(0xe64fd - code32init_start)
LONG(0xe6516 - code32init_start)
LONG(0xe6534 - code32init_start)
LONG(0xe6578 - code32init_start)
LONG(0xe658e - code32init_start)
LONG(0xe65e9 - code32init_start)
LONG(0xe6648 - code32init_start)
LONG(0xe66b6 - code32init_start)
LONG(0xe66c5 - code32init_start)
LONG(0xe66cb - code32init_start)
LONG(0xe66e1 - code32init_start)
LONG(0xe66e7 - code32init_start)
LONG(0xe6778 - code32init_start)
LONG(0xe6878 - code32init_start)
LONG(0xe68c9 - code32init_start)
LONG(0xe695f - code32init_start)
LONG(0xe6ab5 - code32init_start)
LONG(0xe6b6e - code32init_start)
LONG(0xe6ca7 - code32init_start)
LONG(0xe6cc4 - code32init_start)
LONG(0xe6e7c - code32init_start)
LONG(0xe6ef7 - code32init_start)
LONG(0xe6f4a - code32init_start)
LONG(0xe6f78 - code32init_start)
LONG(0xe6fcd - code32init_start)
LONG(0xe709e - code32init_start)
LONG(0xe70b3 - code32init_start)
LONG(0xe74ea - code32init_start)
LONG(0xe74fb - code32init_start)
LONG(0xe7568 - code32init_start)
LONG(0xe7578 - code32init_start)
LONG(0xe75e9 - code32init_start)
LONG(0xe75f9 - code32init_start)
LONG(0xe78e9 - code32init_start)
LONG(0xe7aba - code32init_start)
LONG(0xe7dda - code32init_start)
LONG(0xe7e33 - code32init_start)
LONG(0xe7e4a - code32init_start)
LONG(0xe7e61 - code32init_start)
LONG(0xe7e7f - code32init_start)
LONG(0xe7f6e - code32init_start)
LONG(0xe810d - code32init_start)
LONG(0xe82b9 - code32init_start)
LONG(0xe82c9 - code32init_start)
LONG(0xe883e - code32init_start)
LONG(0xe8873 - code32init_start)
LONG(0xe887d - code32init_start)
LONG(0xe88ba - code32init_start)
LONG(0xe8ba1 - code32init_start)
LONG(0xe8ba7 - code32init_start)
LONG(0xe8bbd - code32init_start)
LONG(0xe8bc3 - code32init_start)
LONG(0xe8c57 - code32init_start)
LONG(0xe8c79 - code32init_start)
LONG(0xe8cbc - code32init_start)
LONG(0xe8cd4 - code32init_start)
LONG(0xe8cdc - code32init_start)
LONG(0xe8f0a - code32init_start)
LONG(0xe8f14 - code32init_start)
LONG(0xe8f1e - code32init_start)
LONG(0xe8f28 - code32init_start)
LONG(0xe8f9a - code32init_start)
LONG(0xe8faa - code32init_start)
LONG(0xe8fb7 - code32init_start)
LONG(0xe8fc1 - code32init_start)
LONG(0xe8ff3 - code32init_start)
LONG(0xe901f - code32init_start)
LONG(0xe9024 - code32init_start)
LONG(0xe9031 - code32init_start)
LONG(0xe903a - code32init_start)
LONG(0xe9051 - code32init_start)
LONG(0xe9069 - code32init_start)
LONG(0xe90be - code32init_start)
LONG(0xe90ea - code32init_start)
LONG(0xe90ef - code32init_start)
LONG(0xe90fc - code32init_start)
LONG(0xe9105 - code32init_start)
LONG(0xe911c - code32init_start)
LONG(0xe9138 - code32init_start)
LONG(0xe92bb - code32init_start)
LONG(0xe953d - code32init_start)
LONG(0xe9749 - code32init_start)
LONG(0xe9807 - code32init_start)
LONG(0xe9839 - code32init_start)
LONG(0xe9a39 - code32init_start)
LONG(0xe9aad - code32init_start)
LONG(0xe9c46 - code32init_start)
LONG(0xe9cc2 - code32init_start)
LONG(0xe9ce0 - code32init_start)
LONG(0xe9d78 - code32init_start)
LONG(0xe9daa - code32init_start)
LONG(0xe9e65 - code32init_start)
LONG(0xe9ef6 - code32init_start)
LONG(0xe9efb - code32init_start)
LONG(0xe9f4b - code32init_start)
LONG(0xe9f86 - code32init_start)
LONG(0xe9fe1 - code32init_start)
LONG(0xea07a - code32init_start)
LONG(0xea0e1 - code32init_start)
LONG(0xea167 - code32init_start)
LONG(0xea19e - code32init_start)
LONG(0xea1ec - code32init_start)
LONG(0xea209 - code32init_start)
LONG(0xea265 - code32init_start)
LONG(0xea294 - code32init_start)
LONG(0xea34d - code32init_start)
LONG(0xea4c5 - code32init_start)
LONG(0xea4cc - code32init_start)
LONG(0xea508 - code32init_start)
LONG(0xea993 - code32init_start)
LONG(0xea9cf - code32init_start)
LONG(0xea9ee - code32init_start)
LONG(0xeaa56 - code32init_start)
LONG(0xeaaa8 - code32init_start)
LONG(0xeaae1 - code32init_start)
LONG(0xeaaf0 - code32init_start)
LONG(0xeab7d - code32init_start)
LONG(0xeabdc - code32init_start)
LONG(0xeabec - code32init_start)
LONG(0xeac68 - code32init_start)
LONG(0xeadf0 - code32init_start)
LONG(0xeadf7 - code32init_start)
LONG(0xeaee9 - code32init_start)
LONG(0xeaf01 - code32init_start)
LONG(0xeaf7c - code32init_start)
LONG(0xeaf8e - code32init_start)
LONG(0xeafa7 - code32init_start)
LONG(0xeb122 - code32init_start)
LONG(0xeb144 - code32init_start)
LONG(0xeb155 - code32init_start)
LONG(0xeb166 - code32init_start)
LONG(0xeb16b - code32init_start)
LONG(0xeb175 - code32init_start)
LONG(0xeb17b - code32init_start)
LONG(0xeb187 - code32init_start)
LONG(0xeb197 - code32init_start)
LONG(0xeb19d - code32init_start)
LONG(0xeb1ed - code32init_start)
LONG(0xeb202 - code32init_start)
LONG(0xeb309 - code32init_start)
LONG(0xeb326 - code32init_start)
LONG(0xeb339 - code32init_start)
LONG(0xeb3f1 - code32init_start)
LONG(0xeb406 - code32init_start)
LONG(0xeb499 - code32init_start)
LONG(0xeb49e - code32init_start)
LONG(0xeb4a5 - code32init_start)
LONG(0xeb4aa - code32init_start)
LONG(0xeb56c - code32init_start)
LONG(0xeb5ff - code32init_start)
LONG(0xeb654 - code32init_start)
LONG(0xeb658 - code32init_start)
LONG(0xeb65c - code32init_start)
LONG(0xeb660 - code32init_start)
LONG(0xeb664 - code32init_start)
LONG(0xeb668 - code32init_start)
LONG(0xeb66c - code32init_start)
LONG(0xeb670 - code32init_start)
LONG(0xeb674 - code32init_start)
LONG(0xeb678 - code32init_start)
LONG(0xeb67c - code32init_start)
LONG(0xeb680 - code32init_start)
LONG(0xeb684 - code32init_start)
LONG(0xeb688 - code32init_start)
LONG(0xeb68c - code32init_start)
LONG(0xeb690 - code32init_start)
LONG(0xeb694 - code32init_start)
LONG(0xeb698 - code32init_start)
LONG(0xeb69c - code32init_start)
LONG(0xeb6a0 - code32init_start)
LONG(0xeb6a4 - code32init_start)
LONG(0xeb6a8 - code32init_start)
LONG(0xeb6ac - code32init_start)
LONG(0xeb6b0 - code32init_start)
LONG(0xeb6b4 - code32init_start)
LONG(0xeb6b8 - code32init_start)
LONG(0xeb6bc - code32init_start)
LONG(0xeb6c0 - code32init_start)
LONG(0xeb6c4 - code32init_start)
LONG(0xeb6c8 - code32init_start)
LONG(0xeb6cc - code32init_start)
LONG(0xeb6d0 - code32init_start)
LONG(0xeb6d4 - code32init_start)
LONG(0xeb6d8 - code32init_start)
LONG(0xeb6dc - code32init_start)
LONG(0xeb6e0 - code32init_start)
LONG(0xeb6e4 - code32init_start)
LONG(0xeb6e8 - code32init_start)
LONG(0xeb6ec - code32init_start)
LONG(0xebdf0 - code32init_start)
LONG(0xebe04 - code32init_start)
LONG(0xebe30 - code32init_start)
LONG(0xebe44 - code32init_start)
LONG(0xebe70 - code32init_start)
LONG(0xebe84 - code32init_start)
LONG(0xebe98 - code32init_start)
LONG(0xebeac - code32init_start)
LONG(0xebec0 - code32init_start)
LONG(0xebed4 - code32init_start)
LONG(0xebee8 - code32init_start)
LONG(0xebefc - code32init_start)
LONG(0xebf10 - code32init_start)
LONG(0xebf24 - code32init_start)
LONG(0xebf38 - code32init_start)
LONG(0xebf4c - code32init_start)
LONG(0xebf60 - code32init_start)
LONG(0xebfb0 - code32init_start)
LONG(0xebfc4 - code32init_start)
LONG(0xec158 - code32init_start)
LONG(0xec1a8 - code32init_start)
LONG(0xec1ac - code32init_start)
LONG(0xec1b0 - code32init_start)
LONG(0xec1b4 - code32init_start)
LONG(0xec1b8 - code32init_start)
        _reloc_abs_end = ABSOLUTE(.) ;
        _reloc_rel_start = ABSOLUTE(.) ;
LONG(0xdd9f3 - code32init_start)
LONG(0xddab1 - code32init_start)
LONG(0xddb39 - code32init_start)
LONG(0xddc21 - code32init_start)
LONG(0xddc9e - code32init_start)
LONG(0xddf2e - code32init_start)
LONG(0xde34b - code32init_start)
LONG(0xde40c - code32init_start)
LONG(0xde430 - code32init_start)
LONG(0xde483 - code32init_start)
LONG(0xde572 - code32init_start)
LONG(0xde5b0 - code32init_start)
LONG(0xde5cf - code32init_start)
LONG(0xde62d - code32init_start)
LONG(0xde6a8 - code32init_start)
LONG(0xde6bd - code32init_start)
LONG(0xde7ee - code32init_start)
LONG(0xde892 - code32init_start)
LONG(0xde8a5 - code32init_start)
LONG(0xde8be - code32init_start)
LONG(0xde8d6 - code32init_start)
LONG(0xde8e9 - code32init_start)
LONG(0xde970 - code32init_start)
LONG(0xde979 - code32init_start)
LONG(0xde982 - code32init_start)
LONG(0xde9b1 - code32init_start)
LONG(0xde9c1 - code32init_start)
LONG(0xde9d2 - code32init_start)
LONG(0xde9f7 - code32init_start)
LONG(0xdea56 - code32init_start)
LONG(0xdeb77 - code32init_start)
LONG(0xdeb88 - code32init_start)
LONG(0xdec38 - code32init_start)
LONG(0xdedf7 - code32init_start)
LONG(0xdee08 - code32init_start)
LONG(0xdef42 - code32init_start)
LONG(0xdef70 - code32init_start)
LONG(0xdef9f - code32init_start)
LONG(0xdf2fc - code32init_start)
LONG(0xdf30d - code32init_start)
LONG(0xdf324 - code32init_start)
LONG(0xdf32b - code32init_start)
LONG(0xdf33f - code32init_start)
LONG(0xdf346 - code32init_start)
LONG(0xdf359 - code32init_start)
LONG(0xdf368 - code32init_start)
LONG(0xdf37a - code32init_start)
LONG(0xdf38d - code32init_start)
LONG(0xdf3b9 - code32init_start)
LONG(0xdf3e2 - code32init_start)
LONG(0xdf3e7 - code32init_start)
LONG(0xdf407 - code32init_start)
LONG(0xdf433 - code32init_start)
LONG(0xdf449 - code32init_start)
LONG(0xdf45b - code32init_start)
LONG(0xdf472 - code32init_start)
LONG(0xdf485 - code32init_start)
LONG(0xdf49e - code32init_start)
LONG(0xdf4b7 - code32init_start)
LONG(0xdf4c8 - code32init_start)
LONG(0xdf4dd - code32init_start)
LONG(0xdf50b - code32init_start)
LONG(0xdf51d - code32init_start)
LONG(0xdf530 - code32init_start)
LONG(0xdf53a - code32init_start)
LONG(0xdf552 - code32init_start)
LONG(0xdf58a - code32init_start)
LONG(0xdf5c1 - code32init_start)
LONG(0xdf606 - code32init_start)
LONG(0xdf625 - code32init_start)
LONG(0xdf63a - code32init_start)
LONG(0xdf6ed - code32init_start)
LONG(0xdf886 - code32init_start)
LONG(0xdf8a7 - code32init_start)
LONG(0xdf8b5 - code32init_start)
LONG(0xdf8d7 - code32init_start)
LONG(0xdf91c - code32init_start)
LONG(0xdf974 - code32init_start)
LONG(0xdf990 - code32init_start)
LONG(0xdf9b4 - code32init_start)
LONG(0xdf9cd - code32init_start)
LONG(0xdf9e3 - code32init_start)
LONG(0xdfa2a - code32init_start)
LONG(0xdfa3a - code32init_start)
LONG(0xdfa5c - code32init_start)
LONG(0xdfa85 - code32init_start)
LONG(0xdfa9c - code32init_start)
LONG(0xdfaaa - code32init_start)
LONG(0xdfadb - code32init_start)
LONG(0xdfaf5 - code32init_start)
LONG(0xdfb18 - code32init_start)
LONG(0xdfb27 - code32init_start)
LONG(0xdfb37 - code32init_start)
LONG(0xdfb66 - code32init_start)
LONG(0xdfb7a - code32init_start)
LONG(0xdfb8a - code32init_start)
LONG(0xdfbaf - code32init_start)
LONG(0xdfbe6 - code32init_start)
LONG(0xdfc0f - code32init_start)
LONG(0xdfc30 - code32init_start)
LONG(0xdfc50 - code32init_start)
LONG(0xdfc6b - code32init_start)
LONG(0xdfc7f - code32init_start)
LONG(0xdfc9a - code32init_start)
LONG(0xdfd3a - code32init_start)
LONG(0xdfd98 - code32init_start)
LONG(0xdfdc7 - code32init_start)
LONG(0xdfe77 - code32init_start)
LONG(0xdfe89 - code32init_start)
LONG(0xdfee9 - code32init_start)
LONG(0xdff15 - code32init_start)
LONG(0xdff3e - code32init_start)
LONG(0xdff4c - code32init_start)
LONG(0xe0037 - code32init_start)
LONG(0xe0049 - code32init_start)
LONG(0xe0067 - code32init_start)
LONG(0xe0093 - code32init_start)
LONG(0xe00af - code32init_start)
LONG(0xe00cf - code32init_start)
LONG(0xe00df - code32init_start)
LONG(0xe00fb - code32init_start)
LONG(0xe0130 - code32init_start)
LONG(0xe01a9 - code32init_start)
LONG(0xe0237 - code32init_start)
LONG(0xe024a - code32init_start)
LONG(0xe025d - code32init_start)
LONG(0xe0285 - code32init_start)
LONG(0xe029c - code32init_start)
LONG(0xe0552 - code32init_start)
LONG(0xe059c - code32init_start)
LONG(0xe05be - code32init_start)
LONG(0xe05f0 - code32init_start)
LONG(0xe0606 - code32init_start)
LONG(0xe0615 - code32init_start)
LONG(0xe061f - code32init_start)
LONG(0xe0632 - code32init_start)
LONG(0xe0652 - code32init_start)
LONG(0xe0667 - code32init_start)
LONG(0xe067e - code32init_start)
LONG(0xe0692 - code32init_start)
LONG(0xe069f - code32init_start)
LONG(0xe06ad - code32init_start)
LONG(0xe06f3 - code32init_start)
LONG(0xe070d - code32init_start)
LONG(0xe0724 - code32init_start)
LONG(0xe075a - code32init_start)
LONG(0xe078a - code32init_start)
LONG(0xe079d - code32init_start)
LONG(0xe07e3 - code32init_start)
LONG(0xe07e8 - code32init_start)
LONG(0xe0818 - code32init_start)
LONG(0xe0839 - code32init_start)
LONG(0xe084c - code32init_start)
LONG(0xe0890 - code32init_start)
LONG(0xe0a9a - code32init_start)
LONG(0xe0b30 - code32init_start)
LONG(0xe0b89 - code32init_start)
LONG(0xe0bc8 - code32init_start)
LONG(0xe0c34 - code32init_start)
LONG(0xe0d37 - code32init_start)
LONG(0xe0d8c - code32init_start)
LONG(0xe0dc8 - code32init_start)
LONG(0xe0e2a - code32init_start)
LONG(0xe0e85 - code32init_start)
LONG(0xe0ee1 - code32init_start)
LONG(0xe0ef5 - code32init_start)
LONG(0xe0f14 - code32init_start)
LONG(0xe0f1e - code32init_start)
LONG(0xe0f32 - code32init_start)
LONG(0xe0f47 - code32init_start)
LONG(0xe0f58 - code32init_start)
LONG(0xe0f72 - code32init_start)
LONG(0xe0f7c - code32init_start)
LONG(0xe0f92 - code32init_start)
LONG(0xe0f9e - code32init_start)
LONG(0xe0fb0 - code32init_start)
LONG(0xe0fbd - code32init_start)
LONG(0xe0fd0 - code32init_start)
LONG(0xe0fde - code32init_start)
LONG(0xe0fee - code32init_start)
LONG(0xe100c - code32init_start)
LONG(0xe101b - code32init_start)
LONG(0xe1032 - code32init_start)
LONG(0xe1058 - code32init_start)
LONG(0xe106b - code32init_start)
LONG(0xe1221 - code32init_start)
LONG(0xe1230 - code32init_start)
LONG(0xe1256 - code32init_start)
LONG(0xe127a - code32init_start)
LONG(0xe129d - code32init_start)
LONG(0xe12b4 - code32init_start)
LONG(0xe12cf - code32init_start)
LONG(0xe12e6 - code32init_start)
LONG(0xe131b - code32init_start)
LONG(0xe13d5 - code32init_start)
LONG(0xe1460 - code32init_start)
LONG(0xe1470 - code32init_start)
LONG(0xe14f8 - code32init_start)
LONG(0xe154c - code32init_start)
LONG(0xe155c - code32init_start)
LONG(0xe15cc - code32init_start)
LONG(0xe1613 - code32init_start)
LONG(0xe162f - code32init_start)
LONG(0xe16ac - code32init_start)
LONG(0xe16ee - code32init_start)
LONG(0xe175c - code32init_start)
LONG(0xe179f - code32init_start)
LONG(0xe17a9 - code32init_start)
LONG(0xe1846 - code32init_start)
LONG(0xe1861 - code32init_start)
LONG(0xe18db - code32init_start)
LONG(0xe18e6 - code32init_start)
LONG(0xe1905 - code32init_start)
LONG(0xe191a - code32init_start)
LONG(0xe192a - code32init_start)
LONG(0xe1935 - code32init_start)
LONG(0xe1944 - code32init_start)
LONG(0xe1a84 - code32init_start)
LONG(0xe1b19 - code32init_start)
LONG(0xe1b56 - code32init_start)
LONG(0xe1b68 - code32init_start)
LONG(0xe1b85 - code32init_start)
LONG(0xe1b9b - code32init_start)
LONG(0xe1bad - code32init_start)
LONG(0xe1bbf - code32init_start)
LONG(0xe1bef - code32init_start)
LONG(0xe1c5a - code32init_start)
LONG(0xe1c72 - code32init_start)
LONG(0xe1c7f - code32init_start)
LONG(0xe1c90 - code32init_start)
LONG(0xe1d56 - code32init_start)
LONG(0xe1e0c - code32init_start)
LONG(0xe1e73 - code32init_start)
LONG(0xe1e83 - code32init_start)
LONG(0xe1ef0 - code32init_start)
LONG(0xe1f0d - code32init_start)
LONG(0xe1f93 - code32init_start)
LONG(0xe221e - code32init_start)
LONG(0xe228b - code32init_start)
LONG(0xe22bb - code32init_start)
LONG(0xe2312 - code32init_start)
LONG(0xe2347 - code32init_start)
LONG(0xe236d - code32init_start)
LONG(0xe23b0 - code32init_start)
LONG(0xe23e3 - code32init_start)
LONG(0xe2556 - code32init_start)
LONG(0xe259e - code32init_start)
LONG(0xe26be - code32init_start)
LONG(0xe26f8 - code32init_start)
LONG(0xe2710 - code32init_start)
LONG(0xe274c - code32init_start)
LONG(0xe277c - code32init_start)
LONG(0xe27a9 - code32init_start)
LONG(0xe284f - code32init_start)
LONG(0xe285b - code32init_start)
LONG(0xe2867 - code32init_start)
LONG(0xe288b - code32init_start)
LONG(0xe28f2 - code32init_start)
LONG(0xe2929 - code32init_start)
LONG(0xe2951 - code32init_start)
LONG(0xe2981 - code32init_start)
LONG(0xe2a36 - code32init_start)
LONG(0xe2a53 - code32init_start)
LONG(0xe2a64 - code32init_start)
LONG(0xe2ad5 - code32init_start)
LONG(0xe2b0a - code32init_start)
LONG(0xe2b4f - code32init_start)
LONG(0xe2b6c - code32init_start)
LONG(0xe2b8f - code32init_start)
LONG(0xe2bb6 - code32init_start)
LONG(0xe2bc9 - code32init_start)
LONG(0xe2bff - code32init_start)
LONG(0xe2c38 - code32init_start)
LONG(0xe2c6a - code32init_start)
LONG(0xe2cc7 - code32init_start)
LONG(0xe2d5a - code32init_start)
LONG(0xe2e21 - code32init_start)
LONG(0xe2e70 - code32init_start)
LONG(0xe2e7c - code32init_start)
LONG(0xe2ed5 - code32init_start)
LONG(0xe2f3f - code32init_start)
LONG(0xe2fbc - code32init_start)
LONG(0xe3232 - code32init_start)
LONG(0xe327f - code32init_start)
LONG(0xe32a5 - code32init_start)
LONG(0xe32ce - code32init_start)
LONG(0xe32e0 - code32init_start)
LONG(0xe341e - code32init_start)
LONG(0xe347b - code32init_start)
LONG(0xe3505 - code32init_start)
LONG(0xe352d - code32init_start)
LONG(0xe35be - code32init_start)
LONG(0xe365a - code32init_start)
LONG(0xe36b9 - code32init_start)
LONG(0xe37b7 - code32init_start)
LONG(0xe3864 - code32init_start)
LONG(0xe3884 - code32init_start)
LONG(0xe38a1 - code32init_start)
LONG(0xe38c4 - code32init_start)
LONG(0xe38e8 - code32init_start)
LONG(0xe38fd - code32init_start)
LONG(0xe3907 - code32init_start)
LONG(0xe391a - code32init_start)
LONG(0xe3924 - code32init_start)
LONG(0xe394e - code32init_start)
LONG(0xe3959 - code32init_start)
LONG(0xe395e - code32init_start)
LONG(0xe39a1 - code32init_start)
LONG(0xe39c7 - code32init_start)
LONG(0xe39e5 - code32init_start)
LONG(0xe3ac0 - code32init_start)
LONG(0xe3b67 - code32init_start)
LONG(0xe3b83 - code32init_start)
LONG(0xe3b9e - code32init_start)
LONG(0xe3bb5 - code32init_start)
LONG(0xe3bbc - code32init_start)
LONG(0xe3c17 - code32init_start)
LONG(0xe3c29 - code32init_start)
LONG(0xe3cb6 - code32init_start)
LONG(0xe3ccb - code32init_start)
LONG(0xe3cdf - code32init_start)
LONG(0xe3cf3 - code32init_start)
LONG(0xe3cfc - code32init_start)
LONG(0xe3d42 - code32init_start)
LONG(0xe3d78 - code32init_start)
LONG(0xe3d89 - code32init_start)
LONG(0xe3da0 - code32init_start)
LONG(0xe3dd6 - code32init_start)
LONG(0xe3e03 - code32init_start)
LONG(0xe3ebd - code32init_start)
LONG(0xe3eca - code32init_start)
LONG(0xe3f0a - code32init_start)
LONG(0xe3f34 - code32init_start)
LONG(0xe3fc9 - code32init_start)
LONG(0xe3fee - code32init_start)
LONG(0xe3ff9 - code32init_start)
LONG(0xe4017 - code32init_start)
LONG(0xe4069 - code32init_start)
LONG(0xe4095 - code32init_start)
LONG(0xe409d - code32init_start)
LONG(0xe40a8 - code32init_start)
LONG(0xe40d6 - code32init_start)
LONG(0xe4128 - code32init_start)
LONG(0xe417f - code32init_start)
LONG(0xe41e1 - code32init_start)
LONG(0xe423b - code32init_start)
LONG(0xe4280 - code32init_start)
LONG(0xe42cd - code32init_start)
LONG(0xe431d - code32init_start)
LONG(0xe4340 - code32init_start)
LONG(0xe434e - code32init_start)
LONG(0xe4379 - code32init_start)
LONG(0xe439a - code32init_start)
LONG(0xe43a8 - code32init_start)
LONG(0xe43bc - code32init_start)
LONG(0xe4406 - code32init_start)
LONG(0xe4410 - code32init_start)
LONG(0xe443c - code32init_start)
LONG(0xe4449 - code32init_start)
LONG(0xe448d - code32init_start)
LONG(0xe44b8 - code32init_start)
LONG(0xe4532 - code32init_start)
LONG(0xe4548 - code32init_start)
LONG(0xe456c - code32init_start)
LONG(0xe4621 - code32init_start)
LONG(0xe471c - code32init_start)
LONG(0xe4763 - code32init_start)
LONG(0xe4775 - code32init_start)
LONG(0xe47dd - code32init_start)
LONG(0xe49c0 - code32init_start)
LONG(0xe4a04 - code32init_start)
LONG(0xe4a10 - code32init_start)
LONG(0xe4a56 - code32init_start)
LONG(0xe4a71 - code32init_start)
LONG(0xe4a91 - code32init_start)
LONG(0xe4be8 - code32init_start)
LONG(0xe4c0d - code32init_start)
LONG(0xe4cd8 - code32init_start)
LONG(0xe4ce9 - code32init_start)
LONG(0xe4d03 - code32init_start)
LONG(0xe4d1c - code32init_start)
LONG(0xe4d48 - code32init_start)
LONG(0xe4d6d - code32init_start)
LONG(0xe4d9e - code32init_start)
LONG(0xe4dea - code32init_start)
LONG(0xe4e4b - code32init_start)
LONG(0xe4ebd - code32init_start)
LONG(0xe4ede - code32init_start)
LONG(0xe4f0f - code32init_start)
LONG(0xe4fd6 - code32init_start)
LONG(0xe502f - code32init_start)
LONG(0xe50be - code32init_start)
LONG(0xe50d6 - code32init_start)
LONG(0xe50fc - code32init_start)
LONG(0xe510f - code32init_start)
LONG(0xe512f - code32init_start)
LONG(0xe5162 - code32init_start)
LONG(0xe517f - code32init_start)
LONG(0xe526c - code32init_start)
LONG(0xe5291 - code32init_start)
LONG(0xe52af - code32init_start)
LONG(0xe5322 - code32init_start)
LONG(0xe536d - code32init_start)
LONG(0xe539d - code32init_start)
LONG(0xe53a8 - code32init_start)
LONG(0xe53df - code32init_start)
LONG(0xe5504 - code32init_start)
LONG(0xe56af - code32init_start)
LONG(0xe5d05 - code32init_start)
LONG(0xe5e05 - code32init_start)
LONG(0xe5e74 - code32init_start)
LONG(0xe5e8c - code32init_start)
LONG(0xe5eb2 - code32init_start)
LONG(0xe5ee7 - code32init_start)
LONG(0xe6145 - code32init_start)
LONG(0xe6242 - code32init_start)
LONG(0xe625f - code32init_start)
LONG(0xe62b7 - code32init_start)
LONG(0xe62f1 - code32init_start)
LONG(0xe636b - code32init_start)
LONG(0xe6385 - code32init_start)
LONG(0xe6398 - code32init_start)
LONG(0xe6436 - code32init_start)
LONG(0xe645e - code32init_start)
LONG(0xe647e - code32init_start)
LONG(0xe64c6 - code32init_start)
LONG(0xe6507 - code32init_start)
LONG(0xe6511 - code32init_start)
LONG(0xe65b7 - code32init_start)
LONG(0xe65d1 - code32init_start)
LONG(0xe68d3 - code32init_start)
LONG(0xe6977 - code32init_start)
LONG(0xe69fc - code32init_start)
LONG(0xe6a3c - code32init_start)
LONG(0xe6acd - code32init_start)
LONG(0xe6b8c - code32init_start)
LONG(0xe6bc5 - code32init_start)
LONG(0xe6c17 - code32init_start)
LONG(0xe6d1f - code32init_start)
LONG(0xe6d81 - code32init_start)
LONG(0xe6de6 - code32init_start)
LONG(0xe6e9f - code32init_start)
LONG(0xe6fa5 - code32init_start)
LONG(0xe6fea - code32init_start)
LONG(0xe7019 - code32init_start)
LONG(0xe7046 - code32init_start)
LONG(0xe70d0 - code32init_start)
LONG(0xe71df - code32init_start)
LONG(0xe7217 - code32init_start)
LONG(0xe7534 - code32init_start)
LONG(0xe754d - code32init_start)
LONG(0xe75a1 - code32init_start)
LONG(0xe75ba - code32init_start)
LONG(0xe75da - code32init_start)
LONG(0xe761b - code32init_start)
LONG(0xe7687 - code32init_start)
LONG(0xe7714 - code32init_start)
LONG(0xe7735 - code32init_start)
LONG(0xe7801 - code32init_start)
LONG(0xe780a - code32init_start)
LONG(0xe783f - code32init_start)
LONG(0xe7858 - code32init_start)
LONG(0xe7882 - code32init_start)
LONG(0xe7920 - code32init_start)
LONG(0xe7964 - code32init_start)
LONG(0xe7989 - code32init_start)
LONG(0xe79e8 - code32init_start)
LONG(0xe7a37 - code32init_start)
LONG(0xe7a50 - code32init_start)
LONG(0xe7a6b - code32init_start)
LONG(0xe7a8b - code32init_start)
LONG(0xe7a9b - code32init_start)
LONG(0xe7ab1 - code32init_start)
LONG(0xe7ac4 - code32init_start)
LONG(0xe7ae5 - code32init_start)
LONG(0xe7af9 - code32init_start)
LONG(0xe7ba5 - code32init_start)
LONG(0xe7c02 - code32init_start)
LONG(0xe7d15 - code32init_start)
LONG(0xe7d64 - code32init_start)
LONG(0xe7dad - code32init_start)
LONG(0xe7ebf - code32init_start)
LONG(0xe7ed5 - code32init_start)
LONG(0xe7ee8 - code32init_start)
LONG(0xe7f01 - code32init_start)
LONG(0xe7f11 - code32init_start)
LONG(0xe7f4d - code32init_start)
LONG(0xe7fec - code32init_start)
LONG(0xe8027 - code32init_start)
LONG(0xe8131 - code32init_start)
LONG(0xe813e - code32init_start)
LONG(0xe8155 - code32init_start)
LONG(0xe82a2 - code32init_start)
LONG(0xe8312 - code32init_start)
LONG(0xe83e1 - code32init_start)
LONG(0xe83fb - code32init_start)
LONG(0xe843f - code32init_start)
LONG(0xe84e7 - code32init_start)
LONG(0xe8552 - code32init_start)
LONG(0xe8561 - code32init_start)
LONG(0xe8576 - code32init_start)
LONG(0xe85af - code32init_start)
LONG(0xe85c2 - code32init_start)
LONG(0xe85dc - code32init_start)
LONG(0xe85ec - code32init_start)
LONG(0xe8628 - code32init_start)
LONG(0xe8634 - code32init_start)
LONG(0xe864b - code32init_start)
LONG(0xe8664 - code32init_start)
LONG(0xe868d - code32init_start)
LONG(0xe86af - code32init_start)
LONG(0xe86dd - code32init_start)
LONG(0xe8724 - code32init_start)
LONG(0xe8834 - code32init_start)
LONG(0xe88ae - code32init_start)
LONG(0xe88d7 - code32init_start)
LONG(0xe8930 - code32init_start)
LONG(0xe8987 - code32init_start)
LONG(0xe89a8 - code32init_start)
LONG(0xe89de - code32init_start)
LONG(0xe89fe - code32init_start)
LONG(0xe8a20 - code32init_start)
LONG(0xe8a92 - code32init_start)
LONG(0xe8ab2 - code32init_start)
LONG(0xe8abb - code32init_start)
LONG(0xe8ad5 - code32init_start)
LONG(0xe8ade - code32init_start)
LONG(0xe8b1c - code32init_start)
LONG(0xe8b33 - code32init_start)
LONG(0xe8bcd - code32init_start)
LONG(0xe8bf6 - code32init_start)
LONG(0xe8c12 - code32init_start)
LONG(0xe8c94 - code32init_start)
LONG(0xe8ccf - code32init_start)
LONG(0xe8e77 - code32init_start)
LONG(0xe8e88 - code32init_start)
LONG(0xe8ea9 - code32init_start)
LONG(0xe9061 - code32init_start)
LONG(0xe909b - code32init_start)
LONG(0xe912f - code32init_start)
LONG(0xe919d - code32init_start)
LONG(0xe91b1 - code32init_start)
LONG(0xe91ca - code32init_start)
LONG(0xe91da - code32init_start)
LONG(0xe91fd - code32init_start)
LONG(0xe920d - code32init_start)
LONG(0xe9232 - code32init_start)
LONG(0xe9242 - code32init_start)
LONG(0xe9277 - code32init_start)
LONG(0xe9294 - code32init_start)
LONG(0xe92a5 - code32init_start)
LONG(0xe92c5 - code32init_start)
LONG(0xe92f4 - code32init_start)
LONG(0xe9315 - code32init_start)
LONG(0xe9328 - code32init_start)
LONG(0xe9331 - code32init_start)
LONG(0xe93dc - code32init_start)
LONG(0xe93ea - code32init_start)
LONG(0xe9499 - code32init_start)
LONG(0xe94b6 - code32init_start)
LONG(0xe94ce - code32init_start)
LONG(0xe951b - code32init_start)
LONG(0xe9530 - code32init_start)
LONG(0xe958d - code32init_start)
LONG(0xe95a7 - code32init_start)
LONG(0xe95db - code32init_start)
LONG(0xe95f6 - code32init_start)
LONG(0xe960e - code32init_start)
LONG(0xe9668 - code32init_start)
LONG(0xe9681 - code32init_start)
LONG(0xe96d4 - code32init_start)
LONG(0xe96e7 - code32init_start)
LONG(0xe96fd - code32init_start)
LONG(0xe9793 - code32init_start)
LONG(0xe97a9 - code32init_start)
LONG(0xe97bb - code32init_start)
LONG(0xe97c5 - code32init_start)
LONG(0xe9822 - code32init_start)
LONG(0xe9834 - code32init_start)
LONG(0xe9868 - code32init_start)
LONG(0xe987b - code32init_start)
LONG(0xe98a4 - code32init_start)
LONG(0xe98b7 - code32init_start)
LONG(0xe98ce - code32init_start)
LONG(0xe98e1 - code32init_start)
LONG(0xe990a - code32init_start)
LONG(0xe991d - code32init_start)
LONG(0xe99e5 - code32init_start)
LONG(0xe9a34 - code32init_start)
LONG(0xe9a62 - code32init_start)
LONG(0xe9ae4 - code32init_start)
LONG(0xe9b1d - code32init_start)
LONG(0xe9b41 - code32init_start)
LONG(0xe9b8e - code32init_start)
LONG(0xe9b9e - code32init_start)
LONG(0xe9bbf - code32init_start)
LONG(0xe9bc4 - code32init_start)
LONG(0xe9bd3 - code32init_start)
LONG(0xe9d5b - code32init_start)
LONG(0xe9e22 - code32init_start)
LONG(0xe9e2e - code32init_start)
LONG(0xe9e97 - code32init_start)
LONG(0xe9ee7 - code32init_start)
LONG(0xe9ef1 - code32init_start)
LONG(0xe9f81 - code32init_start)
LONG(0xea017 - code32init_start)
LONG(0xea04e - code32init_start)
LONG(0xea08d - code32init_start)
LONG(0xea0f9 - code32init_start)
LONG(0xea106 - code32init_start)
LONG(0xea113 - code32init_start)
LONG(0xea122 - code32init_start)
LONG(0xea134 - code32init_start)
LONG(0xea14d - code32init_start)
LONG(0xea15e - code32init_start)
LONG(0xea1d5 - code32init_start)
LONG(0xea24b - code32init_start)
LONG(0xea260 - code32init_start)
LONG(0xea289 - code32init_start)
LONG(0xea2ab - code32init_start)
LONG(0xea2f4 - code32init_start)
LONG(0xea31b - code32init_start)
LONG(0xea333 - code32init_start)
LONG(0xea369 - code32init_start)
LONG(0xea3c4 - code32init_start)
LONG(0xea411 - code32init_start)
LONG(0xea499 - code32init_start)
LONG(0xea4ad - code32init_start)
LONG(0xea4bc - code32init_start)
LONG(0xea4d8 - code32init_start)
LONG(0xea551 - code32init_start)
LONG(0xea568 - code32init_start)
LONG(0xea5db - code32init_start)
LONG(0xea875 - code32init_start)
LONG(0xea93f - code32init_start)
LONG(0xea98a - code32init_start)
LONG(0xeaa0b - code32init_start)
LONG(0xeaa2c - code32init_start)
LONG(0xeaa4a - code32init_start)
LONG(0xeaa4f - code32init_start)
LONG(0xeaa61 - code32init_start)
LONG(0xeaad1 - code32init_start)
LONG(0xeaaeb - code32init_start)
LONG(0xeab27 - code32init_start)
LONG(0xeab3f - code32init_start)
LONG(0xeab94 - code32init_start)
LONG(0xeabb6 - code32init_start)
LONG(0xeabc1 - code32init_start)
LONG(0xeabd0 - code32init_start)
LONG(0xeac47 - code32init_start)
LONG(0xeaca5 - code32init_start)
LONG(0xeacc3 - code32init_start)
LONG(0xeacdf - code32init_start)
LONG(0xeacee - code32init_start)
LONG(0xeacfc - code32init_start)
LONG(0xead37 - code32init_start)
LONG(0xead46 - code32init_start)
LONG(0xead62 - code32init_start)
LONG(0xead9e - code32init_start)
LONG(0xeadbf - code32init_start)
LONG(0xeade1 - code32init_start)
LONG(0xeae42 - code32init_start)
LONG(0xeae60 - code32init_start)
LONG(0xeae83 - code32init_start)
LONG(0xeaef3 - code32init_start)
LONG(0xeaf29 - code32init_start)
LONG(0xeaf61 - code32init_start)
LONG(0xeaf6f - code32init_start)
LONG(0xeaf9b - code32init_start)
LONG(0xeafc2 - code32init_start)
LONG(0xeafd0 - code32init_start)
LONG(0xeaff1 - code32init_start)
LONG(0xeaffa - code32init_start)
LONG(0xeb014 - code32init_start)
LONG(0xeb03f - code32init_start)
LONG(0xeb050 - code32init_start)
LONG(0xeb088 - code32init_start)
LONG(0xeb0cb - code32init_start)
LONG(0xeb104 - code32init_start)
LONG(0xeb191 - code32init_start)
LONG(0xeb1a7 - code32init_start)
LONG(0xeb20c - code32init_start)
LONG(0xeb22e - code32init_start)
LONG(0xeb377 - code32init_start)
LONG(0xeb388 - code32init_start)
LONG(0xeb44a - code32init_start)
LONG(0xeb485 - code32init_start)
LONG(0xeb5eb - code32init_start)
LONG(0xeb631 - code32init_start)
        _reloc_rel_end = ABSOLUTE(.) ;
        _reloc_init_start = ABSOLUTE(.) ;
LONG(0xf0a21 - code32flat_start)
LONG(0xfcc6c - code32flat_start)
        _reloc_init_end = ABSOLUTE(.) ;

. = ( 0xdd100 - code32flat_start ) ;
*32flat.*(.data.varlow../src/tcgbios.c.1414)
. = ( 0xdd101 - code32flat_start ) ;
*32flat.*(.data.varlow../src/tcgbios.c.962)
. = ( 0xdd104 - code32flat_start ) ;
*32flat.*(.data.varlow../src/tcgbios.c.49)
. = ( 0xdd118 - code32flat_start ) ;
*32flat.*(.data.varlow../src/boot.c.1024)
. = ( 0xdd11c - code32flat_start ) ;
*32flat.*(.data.varlow../src/hw/floppy.c.194)
. = ( 0xdd11d - code32flat_start ) ;
*32flat.*(.data.varlow../src/hw/ps2port.c.211)
. = ( 0xdd120 - code32flat_start ) ;
*32flat.*(.data.varlow../src/hw/timer.c.155)
. = ( 0xdd124 - code32flat_start ) ;
*32flat.*(.data.varlow../src/clock.c.30)
. = ( 0xdd125 - code32flat_start ) ;
*32flat.*(.data.varlow../src/sercon.c.552)
. = ( 0xdd128 - code32flat_start ) ;
*32flat.*(.data.varlow../src/sercon.c.551)
. = ( 0xdd138 - code32flat_start ) ;
*32flat.*(.data.varlow../src/sercon.c.68)
. = ( 0xdd139 - code32flat_start ) ;
*32flat.*(.data.varlow../src/sercon.c.67)
. = ( 0xdd13a - code32flat_start ) ;
*32flat.*(.data.varlow../src/sercon.c.66)
. = ( 0xdd13b - code32flat_start ) ;
*32flat.*(.data.varlow../src/sercon.c.65)
. = ( 0xdd13c - code32flat_start ) ;
*32flat.*(.data.varlow../src/sercon.c.64)
. = ( 0xdd13d - code32flat_start ) ;
*32flat.*(.data.varlow../src/sercon.c.51)
. = ( 0xdd13e - code32flat_start ) ;
*32flat.*(.data.varlow../src/sercon.c.50)
. = ( 0xdd140 - code32flat_start ) ;
*32flat.*(.data.varlow../src/sercon.c.49)
. = ( 0xdd144 - code32flat_start ) ;
*32flat.*(.data.varlow../src/disk.c.439)
. = ( 0xdd154 - code32flat_start ) ;
*32flat.*(.data.varlow../src/cdrom.c.25)
. = ( 0xdd158 - code32flat_start ) ;
*32flat.*(.data.varlow../src/cdrom.c.24)
. = ( 0xdd16c - code32flat_start ) ;
*32flat.*(.data.varlow../src/block.c.418)
. = ( 0xdd17c - code32flat_start ) ;
*32flat.*(.data.varlow../src/stacks.c.327)
. = ( 0xdd180 - code32flat_start ) ;
*32flat.*(.data.varlow../src/stacks.c.326)
. = ( 0xdd984 - code32flat_start ) ;
*32flat.*(.data.varlow../src/stacks.c.33)
. = ( 0xdd9a0 - code32flat_start ) ;
*32flat.*(.text.hlist_del)
. = ( 0xdd9af - code32flat_start ) ;
*32flat.*(.text.hlist_add)
. = ( 0xdd9c0 - code32flat_start ) ;
*32flat.*(.text.putc_str)
. = ( 0xdd9ce - code32flat_start ) ;
*32flat.*(.text.memcmp)
. = ( 0xdd9ef - code32flat_start ) ;
*32flat.*(.text.nullTrailingSpace)
. = ( 0xdda1a - code32flat_start ) ;
*32flat.*(.text.pci_config_writew)
. = ( 0xdda5f - code32flat_start ) ;
*32flat.*(.text.pci_config_readb)
. = ( 0xdda9b - code32flat_start ) ;
*32flat.*(.text.pci_find_capability)
. = ( 0xddb0e - code32flat_start ) ;
*32flat.*(.text.pci_next)
. = ( 0xddb54 - code32flat_start ) ;
*32flat.*(.text.ata_extract_version)
. = ( 0xddb74 - code32flat_start ) ;
*32flat.*(.text.found_compatibleahci)
. = ( 0xddb75 - code32flat_start ) ;
*32flat.*(.text.alloc_free)
. = ( 0xddb8e - code32flat_start ) ;
*32flat.*(.text.alloc_find)
. = ( 0xddbad - code32flat_start ) ;
*32flat.*(.text.malloc_getspace)
. = ( 0xddc0c - code32flat_start ) ;
*32flat.*(.text.rom_reserve)
. = ( 0xddc48 - code32flat_start ) ;
*32flat.*(.text.calcRamSize)
. = ( 0xddc96 - code32flat_start ) ;
*32flat.*(.text.romfile_findprefix)
. = ( 0xddccc - code32flat_start ) ;
*32flat.*(.text.glob_prefix)
. = ( 0xddd06 - code32flat_start ) ;
*32flat.*(.text.parse_u32)
. = ( 0xddd34 - code32flat_start ) ;
*32flat.*(.text.add_bev)
. = ( 0xddd8b - code32flat_start ) ;
*32flat.*(.text.pci_find_device)
. = ( 0xdddb3 - code32flat_start ) ;
*32flat.*(.text.pci_init_device)
. = ( 0xdde0a - code32flat_start ) ;
*32flat.*(.text.smbios_next)
. = ( 0xdde6b - code32flat_start ) ;
*32flat.*(.text.smbios_get_tables)
. = ( 0xdde99 - code32flat_start ) ;
*32flat.*(.text.piix_pci_slot_get_irq)
. = ( 0xddec5 - code32flat_start ) ;
*32flat.*(.text.mch_pci_slot_get_irq)
. = ( 0xddeff - code32flat_start ) ;
*32flat.*(.text.piix_ide_setup)
. = ( 0xddf25 - code32flat_start ) ;
*32flat.*(.text.ich9_smbus_setup)
. = ( 0xddf32 - code32flat_start ) ;
*32flat.*(.text.i440fx_mem_addr_setup)
. = ( 0xddf70 - code32flat_start ) ;
*32flat.*(.text.pci_region_align)
. = ( 0xddf8b - code32flat_start ) ;
*32flat.*(.text.pci_region_sum)
. = ( 0xddfb3 - code32flat_start ) ;
*32flat.*(.text.pci_region_migrate_64bit_entries)
. = ( 0xddffd - code32flat_start ) ;
*32flat.*(.text.pci_bios_init_root_regions_mem)
. = ( 0xde0cd - code32flat_start ) ;
*32flat.*(.text.piix4_fadt_setup)
. = ( 0xde119 - code32flat_start ) ;
*32flat.*(.text.ich9_lpc_fadt_setup)
. = ( 0xde164 - code32flat_start ) ;
*32flat.*(.text.getHex)
. = ( 0xde174 - code32flat_start ) ;
*32flat.*(.text.build_notify)
. = ( 0xde216 - code32flat_start ) ;
*32flat.*(.text.parse_resource_int)
. = ( 0xde25e - code32flat_start ) ;
*32flat.*(.text.parse_pkglength)
. = ( 0xde2c4 - code32flat_start ) ;
*32flat.*(.text.const_read_file)
. = ( 0xde2ea - code32flat_start ) ;
*32flat.*(.text.tpm20_write_EfiSpecIdEventStruct)
. = ( 0xde41c - code32flat_start ) ;
*32flat.*(.text.is_pci_vga)
. = ( 0xde463 - code32flat_start ) ;
*32flat.*(.text.romfile_loader_find)
. = ( 0xde4a0 - code32flat_start ) ;
*32flat.*(.text.parse_nameseg)
. = ( 0xde4fb - code32flat_start ) ;
*32flat.*(.text.ata_extract_model.constprop.0)
. = ( 0xde520 - code32flat_start ) ;
*32flat.*(.text.detect_serial.constprop.0)
. = ( 0xde564 - code32flat_start ) ;
*32flat.*(.text.pci_config_maskw.constprop.0)
. = ( 0xde588 - code32flat_start ) ;
*32flat.*(.text.get_acpi_rsdp_length)
. = ( 0xde5ee - code32flat_start ) ;
*32flat.*(.text.build_header.constprop.0)
. = ( 0xde636 - code32flat_start ) ;
*32flat.*(.text.enable_hwirq.constprop.0)
. = ( 0xde66e - code32flat_start ) ;
*32flat.*(.text.pci_set_io_region_addr)
. = ( 0xde6c6 - code32flat_start ) ;
*32flat.*(.text.storage_ide_setup)
. = ( 0xde727 - code32flat_start ) ;
*32flat.*(.text.pic_ibm_setup)
. = ( 0xde73b - code32flat_start ) ;
*32flat.*(.text.apple_macio_setup)
. = ( 0xde74f - code32flat_start ) ;
*32flat.*(.text.getFBSize.isra.0)
. = ( 0xde772 - code32flat_start ) ;
*32flat.*(.text.strtcpy.isra.0)
. = ( 0xde791 - code32flat_start ) ;
*32flat.*(.text.memmove.isra.0)
. = ( 0xde7af - code32flat_start ) ;
*32flat.*(.text.remove_e820)
. = ( 0xde7de - code32flat_start ) ;
*32flat.*(.text.tpm_set_log_area)
. = ( 0xde823 - code32flat_start ) ;
*32flat.*(.text.alloc_new.isra.0)
. = ( 0xde86f - code32flat_start ) ;
*32flat.*(.text.tpm12_get_capability)
. = ( 0xde8e3 - code32flat_start ) ;
*32flat.*(.text.romfile_find)
. = ( 0xde914 - code32flat_start ) ;
*32flat.*(.text.romfile_loadint)
. = ( 0xde96e - code32flat_start ) ;
*32flat.*(.text.msleep)
. = ( 0xde98a - code32flat_start ) ;
*32flat.*(.text.qemu_cfg_read_file)
. = ( 0xde9e4 - code32flat_start ) ;
*32flat.*(.text.wait_preempt.isra.0)
. = ( 0xdea05 - code32flat_start ) ;
*32flat.*(.text.pci_enable_busmaster)
. = ( 0xdea28 - code32flat_start ) ;
*32flat.*(.text.snprintf)
. = ( 0xdea73 - code32flat_start ) ;
*32flat.*(.text.get_field)
. = ( 0xdeabe - code32flat_start ) ;
*32flat.*(.text.acpi_dsdt_find_string)
. = ( 0xdeb0f - code32flat_start ) ;
*32flat.*(.text.smbios_init_type_4)
. = ( 0xded2d - code32flat_start ) ;
*32flat.*(.text.smbios_init_type_17)
. = ( 0xdee7e - code32flat_start ) ;
*32flat.*(.text.build_pci_path.constprop.0)
. = ( 0xdef2e - code32flat_start ) ;
*32flat.*(.text.pci_enable_iobar)
. = ( 0xdef97 - code32flat_start ) ;
*32flat.*(.text.__warn_noalloc)
. = ( 0xdefa7 - code32flat_start ) ;
*32flat.*(.text.add_drive)
. = ( 0xdefc8 - code32flat_start ) ;
*32flat.*(.text.deploy_romfile)
. = ( 0xdf00d - code32flat_start ) ;
*32flat.*(.text.wrmsr_smp)
. = ( 0xdf054 - code32flat_start ) ;
*32flat.*(.text.get_external)
. = ( 0xdf18a - code32flat_start ) ;
*32flat.*(.text.insert_e820)
. = ( 0xdf214 - code32flat_start ) ;
*32flat.*(.text.alloc_new_detail)
. = ( 0xdf29e - code32flat_start ) ;
*32flat.*(.text.alloc_add)
. = ( 0xdf2ef - code32flat_start ) ;
*32flat.*(.text.ahci_port_reset)
. = ( 0xdf383 - code32flat_start ) ;
*32flat.*(.text.piix4_pm_setup)
. = ( 0xdf3d2 - code32flat_start ) ;
*32flat.*(.text.i8042_command)
. = ( 0xdf496 - code32flat_start ) ;
*32flat.*(.text.i8042_flush)
. = ( 0xdf4eb - code32flat_start ) ;
*32flat.*(.text.powerup_await_non_bsy)
. = ( 0xdf561 - code32flat_start ) ;
*32flat.*(.text.malloc_pfree)
. = ( 0xdf5a9 - code32flat_start ) ;
*32flat.*(.text.free)
. = ( 0xdf5c6 - code32flat_start ) ;
*32flat.*(.text.ahci_port_release)
. = ( 0xdf5f4 - code32flat_start ) ;
*32flat.*(.text.__end_thread)
. = ( 0xdf62c - code32flat_start ) ;
*32flat.*(.text.boot_lchs_find)
. = ( 0xdf675 - code32flat_start ) ;
*32flat.*(.text.boot_lchs_find_ata_device.isra.0)
. = ( 0xdf6e0 - code32flat_start ) ;
*32flat.*(.text.find_prio)
. = ( 0xdf721 - code32flat_start ) ;
*32flat.*(.text.is_bootprio_strict)
. = ( 0xdf744 - code32flat_start ) ;
*32flat.*(.text.bootprio_find_pci_device)
. = ( 0xdf766 - code32flat_start ) ;
*32flat.*(.text.bootprio_find_ata_device)
. = ( 0xdf7b1 - code32flat_start ) ;
*32flat.*(.text.bootprio_find_named_rom)
. = ( 0xdf800 - code32flat_start ) ;
*32flat.*(.text.getRomPriority)
. = ( 0xdf874 - code32flat_start ) ;
*32flat.*(.text.pci_enable_membar)
. = ( 0xdf8fe - code32flat_start ) ;
*32flat.*(.text.sdcard_set_frequency)
. = ( 0xdf9a9 - code32flat_start ) ;
*32flat.*(.text.pci_find_resource_reserve_capability)
. = ( 0xdfa45 - code32flat_start ) ;
*32flat.*(.text.pci_bios_init_bus_rec)
. = ( 0xdfc94 - code32flat_start ) ;
*32flat.*(.text.dummy_pci_slot_get_irq)
. = ( 0xdfca5 - code32flat_start ) ;
*32flat.*(.text.pci_region_map_entries)
. = ( 0xdfeb0 - code32flat_start ) ;
*32flat.*(.text.piix_isa_bridge_setup)
. = ( 0xdff21 - code32flat_start ) ;
*32flat.*(.text.fill_dsdt)
. = ( 0xdff55 - code32flat_start ) ;
*32flat.*(.text._vp_read)
. = ( 0xe0147 - code32flat_start ) ;
*32flat.*(.text.vp_get_status)
. = ( 0xe017e - code32flat_start ) ;
*32flat.*(.text._vp_write)
. = ( 0xe02be - code32flat_start ) ;
*32flat.*(.text.vp_get_features)
. = ( 0xe0383 - code32flat_start ) ;
*32flat.*(.text.vp_set_features)
. = ( 0xe0479 - code32flat_start ) ;
*32flat.*(.text.vp_set_status)
. = ( 0xe04bf - code32flat_start ) ;
*32flat.*(.text.vp_reset)
. = ( 0xe0546 - code32flat_start ) ;
*32flat.*(.text.vp_init_mmio)
. = ( 0xe0584 - code32flat_start ) ;
*32flat.*(.text.nvme_init_queue_common)
. = ( 0xe05cf - code32flat_start ) ;
*32flat.*(.text.nvme_wait_csts_rdy)
. = ( 0xe0642 - code32flat_start ) ;
*32flat.*(.text.map_pcirom)
. = ( 0xe085c - code32flat_start ) ;
*32flat.*(.text.e820_add)
. = ( 0xe0a4f - code32flat_start ) ;
*32flat.*(.text.malloc_palloc.part.0)
. = ( 0xe0aab - code32flat_start ) ;
*32flat.*(.text.malloc_palloc)
. = ( 0xe0ab7 - code32flat_start ) ;
*32flat.*(.text.malloc_tmphigh)
. = ( 0xe0ac8 - code32flat_start ) ;
*32flat.*(.text.malloc_tmp)
. = ( 0xe0aec - code32flat_start ) ;
*32flat.*(.text.znprintf)
. = ( 0xe0b4d - code32flat_start ) ;
*32flat.*(.text.qemu_romfile_add)
. = ( 0xe0be1 - code32flat_start ) ;
*32flat.*(.text.pci_region_create_entry)
. = ( 0xe0cb5 - code32flat_start ) ;
*32flat.*(.text.create_bounce_buf)
. = ( 0xe0cf6 - code32flat_start ) ;
*32flat.*(.text.malloc_fseg)
. = ( 0xe0d07 - code32flat_start ) ;
*32flat.*(.text.init_atadrive)
. = ( 0xe0d65 - code32flat_start ) ;
*32flat.*(.text.malloc_high)
. = ( 0xe0d76 - code32flat_start ) ;
*32flat.*(.text.zalloc_page_aligned)
. = ( 0xe0d92 - code32flat_start ) ;
*32flat.*(.text.run_thread)
. = ( 0xe0e3d - code32flat_start ) ;
*32flat.*(.text.romfile_loadfile)
. = ( 0xe0ec0 - code32flat_start ) ;
*32flat.*(.text.ahci_port_setup)
. = ( 0xe1380 - code32flat_start ) ;
*32flat.*(.text.bootentry_add)
. = ( 0xe1431 - code32flat_start ) ;
*32flat.*(.text.boot_add_hd)
. = ( 0xe1450 - code32flat_start ) ;
*32flat.*(.text.pci_probe_devices)
. = ( 0xe1622 - code32flat_start ) ;
*32flat.*(.text.pci_setup)
. = ( 0xe239a - code32flat_start ) ;
*32flat.*(.text.init_floppy)
. = ( 0xe2421 - code32flat_start ) ;
*32flat.*(.text.addFloppy)
. = ( 0xe24c8 - code32flat_start ) ;
*32flat.*(.text.init_controller)
. = ( 0xe256f - code32flat_start ) ;
*32flat.*(.text.found_genericata)
. = ( 0xe2675 - code32flat_start ) ;
*32flat.*(.text.nvme_init_sq)
. = ( 0xe26d9 - code32flat_start ) ;
*32flat.*(.text.sdcard_pio_app.constprop.0)
. = ( 0xe271b - code32flat_start ) ;
*32flat.*(.text.copy_fseg_table)
. = ( 0xe2760 - code32flat_start ) ;
*32flat.*(.text.copy_smbios_21)
. = ( 0xe27ca - code32flat_start ) ;
*32flat.*(.text.smbios_build_tables)
. = ( 0xe29fe - code32flat_start ) ;
*32flat.*(.text.qemu_cfg_detect)
. = ( 0xe2a86 - code32flat_start ) ;
*32flat.*(.text.sdcard_card_setup.constprop.0)
. = ( 0xe2e44 - code32flat_start ) ;
*32flat.*(.text.sdcard_controller_setup)
. = ( 0xe2f6c - code32flat_start ) ;
*32flat.*(.text.sdcard_pci_setup)
. = ( 0xe2f95 - code32flat_start ) ;
*32flat.*(.text.sdcard_romfile_setup)
. = ( 0xe2fd0 - code32flat_start ) ;
*32flat.*(.text.find_resource)
. = ( 0xe3272 - code32flat_start ) ;
*32flat.*(.text.hex.constprop.0)
. = ( 0xe32e8 - code32flat_start ) ;
*32flat.*(.text.parse_namestring)
. = ( 0xe342c - code32flat_start ) ;
*32flat.*(.text.parse_pkg_skip)
. = ( 0xe348b - code32flat_start ) ;
*32flat.*(.text.parse_termarg_int)
. = ( 0xe3511 - code32flat_start ) ;
*32flat.*(.text.parse_termobj)
. = ( 0xe3836 - code32flat_start ) ;
*32flat.*(.text.parse_termlist)
. = ( 0xe3897 - code32flat_start ) ;
*32flat.*(.text.ps2_recvbyte.constprop.0)
. = ( 0xe393a - code32flat_start ) ;
*32flat.*(.text.ps2_sendbyte.constprop.0)
. = ( 0xe398f - code32flat_start ) ;
*32flat.*(.text.ps2_kbd_command)
. = ( 0xe3ad5 - code32flat_start ) ;
*32flat.*(.text.ps2_keyboard_setup)
. = ( 0xe3c20 - code32flat_start ) ;
*32flat.*(.text.mch_mem_addr_setup)
. = ( 0xe3c89 - code32flat_start ) ;
*32flat.*(.text.nvme_admin_identify)
. = ( 0xe3d1c - code32flat_start ) ;
*32flat.*(.text.nvme_controller_setup)
. = ( 0xe432a - code32flat_start ) ;
*32flat.*(.text.send_ata_identity)
. = ( 0xe43d0 - code32flat_start ) ;
*32flat.*(.text.mch_isa_bridge_setup)
. = ( 0xe44a9 - code32flat_start ) ;
*32flat.*(.text.init_optionrom.isra.0)
. = ( 0xe45b6 - code32flat_start ) ;
*32flat.*(.text.run_file_roms)
. = ( 0xe4602 - code32flat_start ) ;
*32flat.*(.text.init_pcirom)
. = ( 0xe4746 - code32flat_start ) ;
*32flat.*(.text.optionrom_setup)
. = ( 0xe4959 - code32flat_start ) ;
*32flat.*(.text.memalign_tmp)
. = ( 0xe498b - code32flat_start ) ;
*32flat.*(.text.qemu_platform_setup)
. = ( 0xe7087 - code32flat_start ) ;
*32flat.*(.text.vp_find_vq)
. = ( 0xe74b1 - code32flat_start ) ;
*32flat.*(.text.intel_igd_setup)
. = ( 0xe75c7 - code32flat_start ) ;
*32flat.*(.text.init_virtio_blk_mmio)
. = ( 0xe77ee - code32flat_start ) ;
*32flat.*(.text.cdrom_media_info)
. = ( 0xe78af - code32flat_start ) ;
*32flat.*(.text.boot_add_cd)
. = ( 0xe7906 - code32flat_start ) ;
*32flat.*(.text.ata_detect)
. = ( 0xe7d9e - code32flat_start ) ;
*32flat.*(.text.ahci_port_detect)
. = ( 0xe7f38 - code32flat_start ) ;
*32flat.*(.text.init_virtio_scsi_mmio)
. = ( 0xe8824 - code32flat_start ) ;
*32flat.*(.text.maininit)
. = ( 0xeac9d - code32flat_start ) ;
*32flat.*(.text.init../src/post.c.303)
. = ( 0xeb435 - code32flat_start ) ;
*32flat.*(.text.init../src/pmm.c.133)
. = ( 0xeb654 - code32flat_start ) ;
*32flat.*(.rodata.find_resource)
. = ( 0xeb668 - code32flat_start ) ;
*32flat.*(.rodata.parse_termarg_int)
. = ( 0xeb69c - code32flat_start ) ;
*32flat.*(.rodata.parse_termobj)
. = ( 0xeb6f0 - code32flat_start ) ;
*32flat.*(.rodata.CSWTCH.1698)
. = ( 0xeb704 - code32flat_start ) ;
*32flat.*(.rodata.__func__.2)
. = ( 0xeb714 - code32flat_start ) ;
*32flat.*(.rodata.__func__.3)
. = ( 0xeb728 - code32flat_start ) ;
*32flat.*(.rodata.__func__.4)
. = ( 0xeb73c - code32flat_start ) ;
*32flat.*(.rodata.__func__.5)
. = ( 0xeb74c - code32flat_start ) ;
*32flat.*(.rodata.__func__.6)
. = ( 0xeb75c - code32flat_start ) ;
*32flat.*(.rodata.__func__.7)
. = ( 0xeb774 - code32flat_start ) ;
*32flat.*(.rodata.__func__.12)
. = ( 0xeb788 - code32flat_start ) ;
*32flat.*(.rodata.__func__.13)
. = ( 0xeb7a0 - code32flat_start ) ;
*32flat.*(.rodata.__func__.14)
. = ( 0xeb7c0 - code32flat_start ) ;
*32flat.*(.rodata.names.15)
. = ( 0xeb82c - code32flat_start ) ;
*32flat.*(.rodata.__func__.17)
. = ( 0xeb838 - code32flat_start ) ;
*32flat.*(.rodata.__func__.19)
. = ( 0xeb84c - code32flat_start ) ;
*32flat.*(.rodata.__func__.20)
. = ( 0xeb85c - code32flat_start ) ;
*32flat.*(.rodata.__func__.21)
. = ( 0xeb870 - code32flat_start ) ;
*32flat.*(.rodata.__func__.22)
. = ( 0xeb880 - code32flat_start ) ;
*32flat.*(.rodata.__func__.23)
. = ( 0xeb890 - code32flat_start ) ;
*32flat.*(.rodata.__func__.24)
. = ( 0xeb8a4 - code32flat_start ) ;
*32flat.*(.rodata.__func__.25)
. = ( 0xeb8b4 - code32flat_start ) ;
*32flat.*(.rodata.__func__.26)
. = ( 0xeb8d4 - code32flat_start ) ;
*32flat.*(.rodata.__func__.27)
. = ( 0xeb8f0 - code32flat_start ) ;
*32flat.*(.rodata.__func__.28)
. = ( 0xeb90c - code32flat_start ) ;
*32flat.*(.rodata.__func__.29)
. = ( 0xeb924 - code32flat_start ) ;
*32flat.*(.rodata.__func__.30)
. = ( 0xeb93c - code32flat_start ) ;
*32flat.*(.rodata.__func__.31)
. = ( 0xeb958 - code32flat_start ) ;
*32flat.*(.rodata.__func__.32)
. = ( 0xeb968 - code32flat_start ) ;
*32flat.*(.rodata.__func__.34)
. = ( 0xeb97c - code32flat_start ) ;
*32flat.*(.rodata.__func__.35)
. = ( 0xeb98c - code32flat_start ) ;
*32flat.*(.rodata.__func__.36)
. = ( 0xeb99c - code32flat_start ) ;
*32flat.*(.rodata.__func__.37)
. = ( 0xeb9a8 - code32flat_start ) ;
*32flat.*(.rodata.__func__.38)
. = ( 0xeb9b4 - code32flat_start ) ;
*32flat.*(.rodata.__func__.39)
. = ( 0xeb9c0 - code32flat_start ) ;
*32flat.*(.rodata.__func__.40)
. = ( 0xeb9cc - code32flat_start ) ;
*32flat.*(.rodata.__func__.41)
. = ( 0xeb9d8 - code32flat_start ) ;
*32flat.*(.rodata.__func__.42)
. = ( 0xeb9e4 - code32flat_start ) ;
*32flat.*(.rodata.__func__.43)
. = ( 0xeb9f0 - code32flat_start ) ;
*32flat.*(.rodata.__func__.44)
. = ( 0xeb9fc - code32flat_start ) ;
*32flat.*(.rodata.__func__.45)
. = ( 0xeba0c - code32flat_start ) ;
*32flat.*(.rodata.__func__.46)
. = ( 0xeba24 - code32flat_start ) ;
*32flat.*(.rodata.__func__.47)
. = ( 0xeba3c - code32flat_start ) ;
*32flat.*(.rodata.__func__.48)
. = ( 0xeba48 - code32flat_start ) ;
*32flat.*(.rodata.__func__.49)
. = ( 0xeba5c - code32flat_start ) ;
*32flat.*(.rodata.__func__.50)
. = ( 0xeba74 - code32flat_start ) ;
*32flat.*(.rodata.__func__.51)
. = ( 0xeba88 - code32flat_start ) ;
*32flat.*(.rodata.__func__.54)
. = ( 0xeba9c - code32flat_start ) ;
*32flat.*(.rodata.__func__.55)
. = ( 0xebaa8 - code32flat_start ) ;
*32flat.*(.rodata.__func__.56)
. = ( 0xebabc - code32flat_start ) ;
*32flat.*(.rodata.__func__.57)
. = ( 0xebad8 - code32flat_start ) ;
*32flat.*(.rodata.__func__.58)
. = ( 0xebae8 - code32flat_start ) ;
*32flat.*(.rodata.__func__.59)
. = ( 0xebaf8 - code32flat_start ) ;
*32flat.*(.rodata.__func__.60)
. = ( 0xebb0c - code32flat_start ) ;
*32flat.*(.rodata.__func__.61)
. = ( 0xebb24 - code32flat_start ) ;
*32flat.*(.rodata.__func__.64)
. = ( 0xebb34 - code32flat_start ) ;
*32flat.*(.rodata.__func__.65)
. = ( 0xebb48 - code32flat_start ) ;
*32flat.*(.rodata.__func__.66)
. = ( 0xebb58 - code32flat_start ) ;
*32flat.*(.rodata.__func__.67)
. = ( 0xebb68 - code32flat_start ) ;
*32flat.*(.rodata.__func__.68)
. = ( 0xebb80 - code32flat_start ) ;
*32flat.*(.rodata.__func__.70)
. = ( 0xebb94 - code32flat_start ) ;
*32flat.*(.rodata.__func__.71)
. = ( 0xebba8 - code32flat_start ) ;
*32flat.*(.rodata.__func__.72)
. = ( 0xebbbc - code32flat_start ) ;
*32flat.*(.rodata.evt_separator.74)
. = ( 0xebbc0 - code32flat_start ) ;
*32flat.*(.rodata.__func__.75)
. = ( 0xebbd4 - code32flat_start ) ;
*32flat.*(.rodata.__func__.78)
. = ( 0xebbe4 - code32flat_start ) ;
*32flat.*(.rodata.__func__.79)
. = ( 0xebbf8 - code32flat_start ) ;
*32flat.*(.rodata.__func__.80)
. = ( 0xebc08 - code32flat_start ) ;
*32flat.*(.rodata.__func__.82)
. = ( 0xebc18 - code32flat_start ) ;
*32flat.*(.rodata.__func__.83)
. = ( 0xebc24 - code32flat_start ) ;
*32flat.*(.rodata.__func__.84)
. = ( 0xebc34 - code32flat_start ) ;
*32flat.*(.rodata.__func__.85)
. = ( 0xebc48 - code32flat_start ) ;
*32flat.*(.rodata.__func__.86)
. = ( 0xebc60 - code32flat_start ) ;
*32flat.*(.rodata.__func__.87)
. = ( 0xebc74 - code32flat_start ) ;
*32flat.*(.rodata.__func__.88)
. = ( 0xebc80 - code32flat_start ) ;
*32flat.*(.rodata.__func__.89)
. = ( 0xebc88 - code32flat_start ) ;
*32flat.*(.rodata.__func__.90)
. = ( 0xebc9c - code32flat_start ) ;
*32flat.*(.rodata.__func__.91)
. = ( 0xebca8 - code32flat_start ) ;
*32flat.*(.rodata.__func__.92)
. = ( 0xebcb8 - code32flat_start ) ;
*32flat.*(.rodata.__func__.93)
. = ( 0xebcc8 - code32flat_start ) ;
*32flat.*(.rodata.__func__.94)
. = ( 0xebce0 - code32flat_start ) ;
*32flat.*(.rodata.__func__.96)
. = ( 0xebcf0 - code32flat_start ) ;
*32flat.*(.rodata.__func__.97)
. = ( 0xebcfc - code32flat_start ) ;
*32flat.*(.rodata.__func__.103)
. = ( 0xebd08 - code32flat_start ) ;
*32flat.*(.rodata.__func__.104)
. = ( 0xebd1c - code32flat_start ) ;
*32flat.*(.rodata.__func__.107)
. = ( 0xebd28 - code32flat_start ) ;
*32flat.*(.rodata.__func__.108)
. = ( 0xebd3c - code32flat_start ) ;
*32flat.*(.rodata.__func__.111)
. = ( 0xebd4c - code32flat_start ) ;
*32flat.*(.rodata.__func__.112)
. = ( 0xebd5c - code32flat_start ) ;
*32flat.*(.rodata.mem_power.121)
. = ( 0xebd64 - code32flat_start ) ;
*32flat.*(.rodata.__func__.193)
. = ( 0xebd74 - code32flat_start ) ;
*32flat.*(.rodata.__func__.194)
. = ( 0xebd80 - code32flat_start ) ;
*32flat.*(.rodata.__func__.195)
. = ( 0xebd94 - code32flat_start ) ;
*32flat.*(.rodata.__func__.196)
. = ( 0xebda0 - code32flat_start ) ;
*32flat.*(.rodata.acpi_find_tbl)
. = ( 0xebde0 - code32flat_start ) ;
*32flat.*(.rodata.fadt_init_tbl)
. = ( 0xebe20 - code32flat_start ) ;
*32flat.*(.rodata.pci_platform_tbl)
. = ( 0xebe60 - code32flat_start ) ;
*32flat.*(.rodata.pci_device_tbl)
. = ( 0xebf78 - code32flat_start ) ;
*32flat.*(.rodata.pci_irqs)
. = ( 0xebf7c - code32flat_start ) ;
*32flat.*(.rodata.region_type_name)
. = ( 0xebfa0 - code32flat_start ) ;
*32flat.*(.rodata.pci_ata_tbl)
. = ( 0xebfdc - code32flat_start ) ;
*32flat.*(.data.prio_halt.81)
. = ( 0xebfe0 - code32flat_start ) ;
*32flat.*(.data.varinit../src/fw/dsdt_parser.c.27)
. = ( 0xec000 - code32flat_start ) ;
*32flat.*(.data.PIR_TABLE)
. = ( 0xec080 - code32flat_start ) ;
*32flat.*(.data.ssdp_pcihp_aml)
. = ( 0xec0e0 - code32flat_start ) ;
*32flat.*(.data.ssdp_proc_aml)
. = ( 0xec158 - code32flat_start ) ;
*32flat.*(.data.pci_slot_get_irq)
. = ( 0xec160 - code32flat_start ) ;
*32flat.*(.data.pci_io_low_end)
. = ( 0xec168 - code32flat_start ) ;
*32flat.*(.data.pcimem64_end)
. = ( 0xec170 - code32flat_start ) ;
*32flat.*(.data.pcimem64_start)
. = ( 0xec178 - code32flat_start ) ;
*32flat.*(.data.pcimem_start)
. = ( 0xec180 - code32flat_start ) ;
*32flat.*(.data.varinit../src/hw/pcidevice.c.16)
. = ( 0xec184 - code32flat_start ) ;
*32flat.*(.data.varinit../src/boot.c.514)
. = ( 0xec188 - code32flat_start ) ;
*32flat.*(.data.DefaultBEVPrio)
. = ( 0xec18c - code32flat_start ) ;
*32flat.*(.data.DefaultHDPrio)
. = ( 0xec190 - code32flat_start ) ;
*32flat.*(.data.DefaultCDPrio)
. = ( 0xec194 - code32flat_start ) ;
*32flat.*(.data.DefaultFloppyPrio)
. = ( 0xec198 - code32flat_start ) ;
*32flat.*(.data.varinit../src/boot.c.245)
. = ( 0xec19c - code32flat_start ) ;
*32flat.*(.data.varinit../src/boot.c.110)
. = ( 0xec1a0 - code32flat_start ) ;
*32flat.*(.data.varinit../src/romfile.c.13)
. = ( 0xec1a4 - code32flat_start ) ;
*32flat.*(.data.RomEnd)
. = ( 0xec1a8 - code32flat_start ) ;
*32flat.*(.data.varinit../src/malloc.c.40)
. = ( 0xec1bc - code32flat_start ) ;
*32flat.*(.data.varinit../src/malloc.c.38)
. = ( 0xec1c4 - code32flat_start ) ;
*32flat.*(.data.varinit../src/malloc.c.37)
. = ( 0xec1c8 - code32flat_start ) ;
*32flat.*(.data.varinit../src/malloc.c.36)
. = ( 0xec1e0 - code32flat_start ) ;
*32flat.*(.bss.used_bitmap.33)
. = ( 0xec200 - code32flat_start ) ;
*32flat.*(.bss.ataid.95)
. = ( 0xec204 - code32flat_start ) ;
*32flat.*(.bss.pci_pad_mem64)
. = ( 0xec208 - code32flat_start ) ;
*32flat.*(.bss.pci_mem64_top)
. = ( 0xec210 - code32flat_start ) ;
*32flat.*(.bss.kvmclock)
. = ( 0xec214 - code32flat_start ) ;
*32flat.*(.bss.kvm_cpuid_base)
. = ( 0xec218 - code32flat_start ) ;
*32flat.*(.bss.CPULongMode)
. = ( 0xec219 - code32flat_start ) ;
*32flat.*(.bss.CPUPhysBits)
. = ( 0xec220 - code32flat_start ) ;
*32flat.*(.bss.RamSizeOver4G)
. = ( 0xec228 - code32flat_start ) ;
*32flat.*(.bss.RamSize)
. = ( 0xec22c - code32flat_start ) ;
*32flat.*(.bss.SMBios30Addr)
. = ( 0xec230 - code32flat_start ) ;
*32flat.*(.bss.SMBios21Addr)
. = ( 0xec234 - code32flat_start ) ;
*32flat.*(.bss.TPM_has_physical_presence)
. = ( 0xec238 - code32flat_start ) ;
*32flat.*(.bss.HaveFDBoot)
. = ( 0xec23c - code32flat_start ) ;
*32flat.*(.bss.HaveHDBoot)
. = ( 0xec240 - code32flat_start ) ;
*32flat.*(.bss.BootorderCount)
. = ( 0xec244 - code32flat_start ) ;
*32flat.*(.bss.BiosGeometryCount)
. = ( 0xec248 - code32flat_start ) ;
*32flat.*(.bss.RunPCIroms)
. = ( 0xec24c - code32flat_start ) ;
*32flat.*(.bss.SpinupEnd)
. = ( 0xec250 - code32flat_start ) ;
*32flat.*(.bss.CDCount)
. = ( 0xec251 - code32flat_start ) ;
*32flat.*(.bss.ThreadControl)
. = ( 0xec260 - code32flat_start ) ;
*32flat.*(.text.switch_next)
. = ( 0xec27e - code32flat_start ) ;
*32flat.*(.text.putc)
. = ( 0xec283 - code32flat_start ) ;
*32flat.*(.text.putuint)
. = ( 0xec2d1 - code32flat_start ) ;
*32flat.*(.text.putsinglehex)
. = ( 0xec2ed - code32flat_start ) ;
*32flat.*(.text.puthex)
. = ( 0xec386 - code32flat_start ) ;
*32flat.*(.text.putprettyhex)
. = ( 0xec3db - code32flat_start ) ;
*32flat.*(.text.strlen)
. = ( 0xec3ec - code32flat_start ) ;
*32flat.*(.text.strcmp)
. = ( 0xec40c - code32flat_start ) ;
*32flat.*(.text.pci_config_writel)
. = ( 0xec44b - code32flat_start ) ;
*32flat.*(.text.pci_config_writeb)
. = ( 0xec48e - code32flat_start ) ;
*32flat.*(.text.pci_config_readl)
. = ( 0xec4c2 - code32flat_start ) ;
*32flat.*(.text.pci_config_readw)
. = ( 0xec500 - code32flat_start ) ;
*32flat.*(.text.qemu_debug_putc)
. = ( 0xec50e - code32flat_start ) ;
*32flat.*(.text.debug_putc)
. = ( 0xec516 - code32flat_start ) ;
*32flat.*(.text.rom_get_max)
. = ( 0xec527 - code32flat_start ) ;
*32flat.*(.text.cpuid)
. = ( 0xec57e - code32flat_start ) ;
*32flat.*(.text.make_bios_readonly_intel)
. = ( 0xec61b - code32flat_start ) ;
*32flat.*(.text.mch_isa_lpc_setup)
. = ( 0xec660 - code32flat_start ) ;
*32flat.*(.text.piix4_pm_config_setup)
. = ( 0xec6cd - code32flat_start ) ;
*32flat.*(.text.ich9_smbus_enable)
. = ( 0xec703 - code32flat_start ) ;
*32flat.*(.text.smp_write_msrs)
. = ( 0xec72b - code32flat_start ) ;
*32flat.*(.text.apic_id_init)
. = ( 0xec7a2 - code32flat_start ) ;
*32flat.*(.text.crb_get_tpm_version)
. = ( 0xec7a5 - code32flat_start ) ;
*32flat.*(.text.crb_activate)
. = ( 0xec7b5 - code32flat_start ) ;
*32flat.*(.text.crb_waitdatavalid)
. = ( 0xec7b8 - code32flat_start ) ;
*32flat.*(.text.tpm_log_event)
. = ( 0xec827 - code32flat_start ) ;
*32flat.*(.text.set_timeouts)
. = ( 0xec87e - code32flat_start ) ;
*32flat.*(.text.cpu_to_be32)
. = ( 0xec881 - code32flat_start ) ;
*32flat.*(.text.sha1_block)
. = ( 0xec9ea - code32flat_start ) ;
*32flat.*(.text.tpmhw_transmit)
. = ( 0xeca5c - code32flat_start ) ;
*32flat.*(.text.sha256_block)
. = ( 0xecc80 - code32flat_start ) ;
*32flat.*(.text.code_mutable_preinit)
. = ( 0xecc9c - code32flat_start ) ;
*32flat.*(.text.tis_get_tpm_version)
. = ( 0xeccc3 - code32flat_start ) ;
*32flat.*(.text.crb_senddata)
. = ( 0xeccee - code32flat_start ) ;
*32flat.*(.text.init_timeout)
. = ( 0xecd44 - code32flat_start ) ;
*32flat.*(.text.crb_init)
. = ( 0xecd74 - code32flat_start ) ;
*32flat.*(.text.tis_init)
. = ( 0xecd88 - code32flat_start ) ;
*32flat.*(.text.cpu_to_be64)
. = ( 0xecd97 - code32flat_start ) ;
*32flat.*(.text.sha512_block)
. = ( 0xed2ac - code32flat_start ) ;
*32flat.*(.text.crb_readresp)
. = ( 0xed306 - code32flat_start ) ;
*32flat.*(.text.checksum)
. = ( 0xed316 - code32flat_start ) ;
*32flat.*(.text.ahci_port_writel.isra.0)
. = ( 0xed329 - code32flat_start ) ;
*32flat.*(.text.ahci_port_readl.isra.0)
. = ( 0xed338 - code32flat_start ) ;
*32flat.*(.text.default_process_op.isra.0)
. = ( 0xed351 - code32flat_start ) ;
*32flat.*(.text.memset.isra.0)
. = ( 0xed35c - code32flat_start ) ;
*32flat.*(.text.scsi_fill_cmd.constprop.0)
. = ( 0xed417 - code32flat_start ) ;
*32flat.*(.text.sha512_do)
. = ( 0xed54c - code32flat_start ) ;
*32flat.*(.text.sha384)
. = ( 0xed57f - code32flat_start ) ;
*32flat.*(.text.sha512)
. = ( 0xed5b2 - code32flat_start ) ;
*32flat.*(.text.sha256)
. = ( 0xed6b8 - code32flat_start ) ;
*32flat.*(.text.tpm_simple_cmd)
. = ( 0xed765 - code32flat_start ) ;
*32flat.*(.text.tpm20_hierarchycontrol.constprop.0.isra.0)
. = ( 0xed7d3 - code32flat_start ) ;
*32flat.*(.text.tpm_set_failure)
. = ( 0xed81c - code32flat_start ) ;
*32flat.*(.text.tpm20_extend)
. = ( 0xed8b7 - code32flat_start ) ;
*32flat.*(.text.tpm_extend)
. = ( 0xed949 - code32flat_start ) ;
*32flat.*(.text.sha1_do)
. = ( 0xeda2f - code32flat_start ) ;
*32flat.*(.text.sha1)
. = ( 0xeda62 - code32flat_start ) ;
*32flat.*(.text.tpm_build_digest)
. = ( 0xedbe9 - code32flat_start ) ;
*32flat.*(.text.tpm_add_measurement_to_log)
. = ( 0xedc83 - code32flat_start ) ;
*32flat.*(.text.tpm_add_action)
. = ( 0xedca9 - code32flat_start ) ;
*32flat.*(.text.hash_log_extend.constprop.0)
. = ( 0xedd51 - code32flat_start ) ;
*32flat.*(.text.timer_read)
. = ( 0xedda4 - code32flat_start ) ;
*32flat.*(.text.timer_calc)
. = ( 0xeddb7 - code32flat_start ) ;
*32flat.*(.text.timer_calc_usec)
. = ( 0xeddfb - code32flat_start ) ;
*32flat.*(.text.timer_check)
. = ( 0xede0f - code32flat_start ) ;
*32flat.*(.text.timer_delay)
. = ( 0xede23 - code32flat_start ) ;
*32flat.*(.text.udelay)
. = ( 0xede2d - code32flat_start ) ;
*32flat.*(.text.pci_ioconfig_next.constprop.0)
. = ( 0xede9e - code32flat_start ) ;
*32flat.*(.text.__make_bios_writable_intel)
. = ( 0xedf59 - code32flat_start ) ;
*32flat.*(.text.make_bios_writable_intel)
. = ( 0xedf98 - code32flat_start ) ;
*32flat.*(.text.bvprintf)
. = ( 0xee209 - code32flat_start ) ;
*32flat.*(.text.panic)
. = ( 0xee21f - code32flat_start ) ;
*32flat.*(.text.call16_override)
. = ( 0xee25c - code32flat_start ) ;
*32flat.*(.text.call16.isra.0)
. = ( 0xee2ad - code32flat_start ) ;
*32flat.*(.text.check_irqs)
. = ( 0xee2c7 - code32flat_start ) ;
*32flat.*(.text.yield)
. = ( 0xee2f4 - code32flat_start ) ;
*32flat.*(.text.qemu_cfg_dma_transfer)
. = ( 0xee348 - code32flat_start ) ;
*32flat.*(.text.qemu_cfg_read.part.0)
. = ( 0xee369 - code32flat_start ) ;
*32flat.*(.text.qemu_cfg_read_entry)
. = ( 0xee3a6 - code32flat_start ) ;
*32flat.*(.text.qemu_get_present_cpus_count)
. = ( 0xee3f1 - code32flat_start ) ;
*32flat.*(.text.qemu_cfg_skip)
. = ( 0xee41a - code32flat_start ) ;
*32flat.*(.text.printf)
. = ( 0xee42d - code32flat_start ) ;
*32flat.*(.text.boot_fail)
. = ( 0xee509 - code32flat_start ) ;
*32flat.*(.text.__dprintf)
. = ( 0xee57b - code32flat_start ) ;
*32flat.*(.text.__warn_internalerror)
. = ( 0xee58b - code32flat_start ) ;
*32flat.*(.text.qemu_cfg_write_file_simple)
. = ( 0xee5f8 - code32flat_start ) ;
*32flat.*(.text.__warn_timeout)
. = ( 0xee608 - code32flat_start ) ;
*32flat.*(.text.await_ide.constprop.0)
. = ( 0xee65c - code32flat_start ) ;
*32flat.*(.text.await_not_bsy)
. = ( 0xee66b - code32flat_start ) ;
*32flat.*(.text.ndelay_await_not_bsy)
. = ( 0xee69f - code32flat_start ) ;
*32flat.*(.text.send_cmd)
. = ( 0xee77c - code32flat_start ) ;
*32flat.*(.text.wait_reg8)
. = ( 0xee7c8 - code32flat_start ) ;
*32flat.*(.text.crb_probe)
. = ( 0xee831 - code32flat_start ) ;
*32flat.*(.text.tis_activate)
. = ( 0xee89f - code32flat_start ) ;
*32flat.*(.text.tis_find_active_locality)
. = ( 0xee8c6 - code32flat_start ) ;
*32flat.*(.text.tis_readresp)
. = ( 0xee905 - code32flat_start ) ;
*32flat.*(.text.tis_probe)
. = ( 0xee963 - code32flat_start ) ;
*32flat.*(.text.crb_waitrespready)
. = ( 0xee97f - code32flat_start ) ;
*32flat.*(.text.crb_ready)
. = ( 0xee9a4 - code32flat_start ) ;
*32flat.*(.text.tis_ready)
. = ( 0xee9d9 - code32flat_start ) ;
*32flat.*(.text.tis_waitdatavalid)
. = ( 0xeea0d - code32flat_start ) ;
*32flat.*(.text.tis_waitrespready)
. = ( 0xeea4c - code32flat_start ) ;
*32flat.*(.text.tis_senddata)
. = ( 0xeeaf2 - code32flat_start ) ;
*32flat.*(.text.sdcard_reset.isra.0)
. = ( 0xeeb2b - code32flat_start ) ;
*32flat.*(.text.pic_setup)
. = ( 0xeeb5b - code32flat_start ) ;
*32flat.*(.text.i8042_wait_write)
. = ( 0xeeb97 - code32flat_start ) ;
*32flat.*(.text.ata_wait_data)
. = ( 0xeebe7 - code32flat_start ) ;
*32flat.*(.text.is_valid_rom)
. = ( 0xeec50 - code32flat_start ) ;
*32flat.*(.text.ahci_command)
. = ( 0xeeeee - code32flat_start ) ;
*32flat.*(.text.ahci_disk_readwrite_aligned)
. = ( 0xef011 - code32flat_start ) ;
*32flat.*(.text.ahci_disk_readwrite)
. = ( 0xef0e0 - code32flat_start ) ;
*32flat.*(.text.sdcard_waitw)
. = ( 0xef14b - code32flat_start ) ;
*32flat.*(.text.find_acpi_table)
. = ( 0xef238 - code32flat_start ) ;
*32flat.*(.text.make_bios_readonly)
. = ( 0xef282 - code32flat_start ) ;
*32flat.*(.text.nvme_commit_sqe)
. = ( 0xef2b0 - code32flat_start ) ;
*32flat.*(.text.nvme_wait)
. = ( 0xef3cb - code32flat_start ) ;
*32flat.*(.text.sdcard_pio)
. = ( 0xef491 - code32flat_start ) ;
*32flat.*(.text.sdcard_pio_transfer)
. = ( 0xef5a1 - code32flat_start ) ;
*32flat.*(.text.make_bios_writable)
. = ( 0xef623 - code32flat_start ) ;
*32flat.*(.text.smp_scan)
. = ( 0xef73c - code32flat_start ) ;
*32flat.*(.text.mch_mmconfig_setup)
. = ( 0xef792 - code32flat_start ) ;
*32flat.*(.text.nvme_get_next_sqe.constprop.0)
. = ( 0xef820 - code32flat_start ) ;
*32flat.*(.text.nvme_io_xfer)
. = ( 0xef8f8 - code32flat_start ) ;
*32flat.*(.text.ata_pio_transfer.constprop.0)
. = ( 0xef9a4 - code32flat_start ) ;
*32flat.*(.text.__callrom)
. = ( 0xefa30 - code32flat_start ) ;
*32flat.*(.text.call_boot_entry)
. = ( 0xefa92 - code32flat_start ) ;
*32flat.*(.text.__call16_int.constprop.0)
. = ( 0xefab4 - code32flat_start ) ;
*32flat.*(.text.boot_disk)
. = ( 0xefbac - code32flat_start ) ;
*32flat.*(.text.screenc)
. = ( 0xefc00 - code32flat_start ) ;
*32flat.*(.text.screen_putc)
. = ( 0xefc2d - code32flat_start ) ;
*32flat.*(.text.runtime../src/block.c.571)
. = ( 0xf00f5 - code32flat_start ) ;
*32flat.*(.text.process_op)
. = ( 0xf0156 - code32flat_start ) ;
*32flat.*(.text.scsi_is_ready)
. = ( 0xf027b - code32flat_start ) ;
*32flat.*(.text.cdrom_boot)
. = ( 0xf057e - code32flat_start ) ;
*32flat.*(.text.do_boot)
. = ( 0xf06f7 - code32flat_start ) ;
*32flat.*(.text.runtime../src/resume.c.146)
. = ( 0xf09b7 - code32flat_start ) ;
*32flat.*(.text.runtime../src/post.c.182)
. = ( 0xf09fd - code32flat_start ) ;
*32flat.*(.text.runtime../src/post.c.320)
. = ( 0xf0a25 - code32flat_start ) ;
*32flat.*(.text.runtime../src/boot.c.1027)
. = ( 0xf0a51 - code32flat_start ) ;
*32flat.*(.text.runtime../src/boot.c.1037)
. = ( 0xf0a7e - code32flat_start ) ;
*32flat.*(.text.runtime../src/tcgbios.c.1653)
. = ( 0xf0d94 - code32flat_start ) ;
*32flat.*(.text.runtime../src/fw/smp.c.83)
. = ( 0xf0dc0 - code32flat_start ) ;
_rodata32flat = . ;
*32flat.*(.rodata)
. = ( 0xf5210 - code32flat_start ) ;
*32flat.*(.rodata.puthex)
. = ( 0xf522c - code32flat_start ) ;
*32flat.*(.rodata.runtime../src/tcgbios.c.1653)
. = ( 0xf5260 - code32flat_start ) ;
*32flat.*(.rodata.sha_ko.0)
. = ( 0xf54e0 - code32flat_start ) ;
*32flat.*(.rodata.sha_ko.1)
. = ( 0xf55e0 - code32flat_start ) ;
*32flat.*(.rodata.__func__.8)
. = ( 0xf55ec - code32flat_start ) ;
*32flat.*(.rodata.__func__.9)
. = ( 0xf55fc - code32flat_start ) ;
*32flat.*(.rodata.__func__.10)
. = ( 0xf560c - code32flat_start ) ;
*32flat.*(.rodata.__func__.11)
. = ( 0xf5618 - code32flat_start ) ;
*32flat.*(.rodata.__func__.52)
. = ( 0xf5628 - code32flat_start ) ;
*32flat.*(.rodata.__func__.53)
. = ( 0xf5640 - code32flat_start ) ;
*32flat.*(.rodata.__func__.62)
. = ( 0xf5650 - code32flat_start ) ;
*32flat.*(.rodata.__func__.63)
. = ( 0xf5660 - code32flat_start ) ;
*32flat.*(.rodata.__func__.69)
. = ( 0xf5670 - code32flat_start ) ;
*32flat.*(.rodata.sha_ko.73)
. = ( 0xf5680 - code32flat_start ) ;
*32flat.*(.rodata.__func__.76)
. = ( 0xf568c - code32flat_start ) ;
*32flat.*(.rodata.__func__.77)
. = ( 0xf5698 - code32flat_start ) ;
*32flat.*(.rodata.__func__.99)
. = ( 0xf56a4 - code32flat_start ) ;
*32flat.*(.rodata.__func__.113)
. = ( 0xf56b8 - code32flat_start ) ;
*32flat.*(.rodata.tpm_default_durations)
. = ( 0xf56c4 - code32flat_start ) ;
*32flat.*(.rodata.tis_default_timeouts)
. = ( 0xf56e0 - code32flat_start ) ;
*32flat.*(.rodata.hash_parameters)
. = ( 0xf5740 - code32flat_start ) ;
*32flat.*(.data.TPMHW_driver_to_use)
. = ( 0xf5760 - code32flat_start ) ;
*32flat.*(.data.tpm_drivers)
. = ( 0xf57c0 - code32flat_start ) ;
*32flat.*(.data.MCHMmcfgBDF)
. = ( 0xf57c4 - code32flat_start ) ;
*32flat.*(.data.ICH9SmbusBDF)
. = ( 0xf57c8 - code32flat_start ) ;
*32flat.*(.data.PiixPmBDF)
. = ( 0xf57cc - code32flat_start ) ;
*32flat.*(.data.ICH9LpcBDF)
. = ( 0xf57d0 - code32flat_start ) ;
*32flat.*(.data.ShadowBDF)
. = ( 0xf57d4 - code32flat_start ) ;
*32flat.*(.data.acpi_pm_base)
. = ( 0xf57d8 - code32flat_start ) ;
*32flat.*(.data.CheckFloppySig)
. = ( 0xf57dc - code32flat_start ) ;
*32flat.*(.data.screeninfo)
. = ( 0xf57e0 - code32flat_start ) ;
*32flat.*(.data.debuginfo)
. = ( 0xf5800 - code32flat_start ) ;
*32flat.*(.data.BUILDINFO)
. = ( 0xf5860 - code32flat_start ) ;
*32flat.*(.data.VERSION)
. = ( 0xf5884 - code32flat_start ) ;
*32flat.*(.bss.nvme_dma_buffer)
. = ( 0xf5888 - code32flat_start ) ;
*32flat.*(.bss.crb_resp)
. = ( 0xf588c - code32flat_start ) ;
*32flat.*(.bss.crb_cmd)
. = ( 0xf5890 - code32flat_start ) ;
*32flat.*(.bss.crb_cmd_size)
. = ( 0xf5894 - code32flat_start ) ;
*32flat.*(.bss.tpm_default_to)
. = ( 0xf58a4 - code32flat_start ) ;
*32flat.*(.bss.tpm_default_dur)
. = ( 0xf58b0 - code32flat_start ) ;
*32flat.*(.bss.romfile_pointer_list)
. = ( 0xf58b4 - code32flat_start ) ;
*32flat.*(.bss.SMPStack)
. = ( 0xf58b8 - code32flat_start ) ;
*32flat.*(.bss.SMPLock)
. = ( 0xf58c0 - code32flat_start ) ;
*32flat.*(.bss.FoundAPICIDs)
. = ( 0xf58e0 - code32flat_start ) ;
*32flat.*(.bss.CountCPUs)
. = ( 0xf58e4 - code32flat_start ) ;
*32flat.*(.bss.MaxCountCPUs)
. = ( 0xf58e8 - code32flat_start ) ;
*32flat.*(.bss.smp_msr_count)
. = ( 0xf5900 - code32flat_start ) ;
*32flat.*(.bss.smp_msr)
. = ( 0xf5a80 - code32flat_start ) ;
*32flat.*(.bss.cfg_dma_enabled)
. = ( 0xf5a84 - code32flat_start ) ;
*32flat.*(.bss.cfg_enabled)
. = ( 0xf5a88 - code32flat_start ) ;
*32flat.*(.bss.RsdpAddr)
. = ( 0xf5a8c - code32flat_start ) ;
*32flat.*(.bss.tpm20_pcr_selection)
. = ( 0xf5a90 - code32flat_start ) ;
*32flat.*(.bss.tpm20_pcr_selection_size)
. = ( 0xf5a94 - code32flat_start ) ;
*32flat.*(.bss.TPM_version)
. = ( 0xf5a98 - code32flat_start ) ;
*32flat.*(.bss.BEVCount)
. = ( 0xf5aa0 - code32flat_start ) ;
*32flat.*(.bss.BEV)
. = ( 0xf5b40 - code32flat_start ) ;
*32flat.*(.bss.BootRetryTime)
. = ( 0xf5b44 - code32flat_start ) ;
*32flat.*(.bss.VgaROM)
. = ( 0xf5b48 - code32flat_start ) ;
*32flat.*(.bss.ScreenAndDebug)
. = ( 0xf5b4c - code32flat_start ) ;
*32flat.*(.bss.S3ResumeVga)
. = ( 0xf5b50 - code32flat_start ) ;
*32flat.*(.bss.EnforceChecksum)
. = ( 0xf5b54 - code32flat_start ) ;
*32flat.*(.bss.RomBase)
. = ( 0xf5b58 - code32flat_start ) ;
*32flat.*(.bss.mmconfig)
. = ( 0xf5b5c - code32flat_start ) ;
*32flat.*(.bss.CanInterrupt)
. = ( 0xf6360 - code32flat_start ) ;
*32flat.*(.data.varfseg../src/fw/paravirt.c.40)
. = ( 0xf6364 - code32flat_start ) ;
*32flat.*(.data.varfseg../src/fw/biostables.c.196)
. = ( 0xf6368 - code32flat_start ) ;
*32flat.*(.data.varfseg../src/fw/biostables.c.22)
. = ( 0xf636c - code32flat_start ) ;
*32flat.*(.data.varfseg../src/hw/pcidevice.c.17)
. = ( 0xf6370 - code32flat_start ) ;
*32flat.*(.data.varfseg../src/pmm.c.20)
. = ( 0xf6380 - code32flat_start ) ;
*32flat.*(.data.varfseg../src/malloc.c.473)
. = ( 0xf6384 - code32flat_start ) ;
*32flat.*(.data.varfseg../src/e820map.c.19)
. = ( 0xf63a0 - code32flat_start ) ;
*32flat.*(.data.varfseg../src/e820map.c.18)
. = ( 0xf6da0 - code32flat_start ) ;
*32flat.*(.data.varfseg../src/hw/floppy.c.88)
. = ( 0xf6dfc - code32flat_start ) ;
*32flat.*(.data.varfseg../src/hw/floppy.c.55)
. = ( 0xf6e0a - code32flat_start ) ;
*32flat.*(.data.varfseg../src/hw/serialio.c.104)
. = ( 0xf6e0c - code32flat_start ) ;
*32flat.*(.data.varfseg../src/hw/timer.c.53)
. = ( 0xf6e10 - code32flat_start ) ;
*32flat.*(.data.varfseg../src/hw/timer.c.52)
. = ( 0xf6e20 - code32flat_start ) ;
*32flat.*(.data.varfseg../src/pcibios.c.229)
. = ( 0xf6e30 - code32flat_start ) ;
*32flat.*(.data.varfseg../src/vgahooks.c.262)
. = ( 0xf6e31 - code32flat_start ) ;
*32flat.*(.data.varfseg../src/vgahooks.c.179)
. = ( 0xf6e34 - code32flat_start ) ;
*32flat.*(.data.varfseg../src/vgahooks.c.40)
. = ( 0xf6e3c - code32flat_start ) ;
*32flat.*(.data.varfseg../src/vgahooks.c.22)
. = ( 0xf6e40 - code32flat_start ) ;
*32flat.*(.data.varfseg../src/pnpbios.c.18)
. = ( 0xf6e64 - code32flat_start ) ;
*32flat.*(.data.varfseg../src/sercon.c.52)
. = ( 0xf6e68 - code32flat_start ) ;
*32flat.*(.data.varfseg../src/cdrom.c.26)
. = ( 0xf6e6c - code32flat_start ) ;
*32flat.*(.data.varfseg../src/block.c.34)
. = ( 0xf6e80 - code32flat_start ) ;
*32flat.*(.data.varfseg../src/block.c.33)
. = ( 0xf6f40 - code32flat_start ) ;
*32flat.*(.data.varfseg../src/block.c.31)
. = ( 0xf6f44 - code32flat_start ) ;
*32flat.*(.data.varfseg../src/stacks.c.696)
. = ( 0xf6f48 - code32flat_start ) ;
*32flat.*(.data.varfseg../src/stacks.c.476)
. = ( 0xf6f54 - code32flat_start ) ;
*32flat.*(.data.varfseg../src/misc.c.166)
. = ( 0xf6f60 - code32flat_start ) ;
*32flat.*(.data.varfseg../src/misc.c.148)
. = ( 0xf6f98 - code32flat_start ) ;
*32flat.*(.data.varfseg../src/misc.c.142)
. = ( 0xf6f9e - code32flat_start ) ;
*32flat.*(.data.varfseg../src/misc.c.139)
. = ( 0xf6fa0 - code32flat_start ) ;
*32flat.*(.data.varfseg../src/misc.c.132)
. = ( 0xf6fa8 - code32flat_start ) ;
*32flat.*(.data.varfseg../src/misc.c.18)
. = ( 0xf6fb0 - code32flat_start ) ;
*32flat.*(.text.32fseg../src/stacks.c.300)
. = ( 0xf6fd4 - code32flat_start ) ;
*32seg.*(.text.set_code_success)
. = ( 0xf6fde - code32flat_start ) ;
*32seg.*(.text.get_global_offset)
. = ( 0xf6fea - code32flat_start ) ;
*32seg.*(.text.qemu_debug_putc)
. = ( 0xf7002 - code32flat_start ) ;
*32seg.*(.text.putsinglehex.constprop.0)
. = ( 0xf701c - code32flat_start ) ;
*32seg.*(.text.puthex.constprop.0)
. = ( 0xf70bb - code32flat_start ) ;
*32seg.*(.text.pci_next)
. = ( 0xf712f - code32flat_start ) ;
*32seg.*(.text.putuint.constprop.0)
. = ( 0xf716e - code32flat_start ) ;
*32seg.*(.text.__dprintf)
. = ( 0xf7402 - code32flat_start ) ;
*32seg.*(.text.dump_regs)
. = ( 0xf746a - code32flat_start ) ;
*32seg.*(.text.__set_code_invalid)
. = ( 0xf7498 - code32flat_start ) ;
*32seg.*(.text.handle_pcibios)
. = ( 0xf7834 - code32flat_start ) ;
*32seg.*(.text.handle_apm)
. = ( 0xf79d8 - code32flat_start ) ;
_rodata32seg = . ;
*32seg.*(.rodata)
. = ( 0xf7ab4 - code32flat_start ) ;
*32seg.*(.rodata.__func__.0)
. = ( 0xf7ac0 - code32flat_start ) ;
*32seg.*(.rodata.__func__.1)
. = ( 0xf7ad0 - code32flat_start ) ;
*32seg.*(.rodata.__func__.2)
. = ( 0xf7ae0 - code32flat_start ) ;
*32seg.*(.rodata.__func__.3)
. = ( 0xf7af0 - code32flat_start ) ;
*32seg.*(.rodata.__func__.4)
. = ( 0xf7b00 - code32flat_start ) ;
*32seg.*(.rodata.__func__.5)
. = ( 0xf7b10 - code32flat_start ) ;
*32seg.*(.rodata.__func__.6)
. = ( 0xf7b20 - code32flat_start ) ;
*16.*(.text.set_a20)
. = ( 0xf7b40 - code32flat_start ) ;
*16.*(.text.enqueue_key)
. = ( 0xf7b9a - code32flat_start ) ;
*16.*(.text.kbd_set_flag)
. = ( 0xf7bf7 - code32flat_start ) ;
*16.*(.text.cursor_pos_row)
. = ( 0xf7c09 - code32flat_start ) ;
*16.*(.text.shiftbuf)
. = ( 0xf7c4f - code32flat_start ) ;
*16.*(.text.lba2chs)
. = ( 0xf7c93 - code32flat_start ) ;
*16.*(.text.need_hop_back)
. = ( 0xf7cb7 - code32flat_start ) ;
*16.*(.text.getLCHS)
. = ( 0xf7d61 - code32flat_start ) ;
*16.*(.text.putsinglehex.constprop.0)
. = ( 0xf7d82 - code32flat_start ) ;
*16.*(.text.puthex.constprop.0)
. = ( 0xf7e55 - code32flat_start ) ;
*16.*(.text.call32_post)
. = ( 0xf7eed - code32flat_start ) ;
*16.*(.text.default_process_op.isra.0)
. = ( 0xf7f0d - code32flat_start ) ;
*16.*(.text.floppy_dor_mask)
. = ( 0xf7f30 - code32flat_start ) ;
*16.*(.text.__debug_isr)
. = ( 0xf7f52 - code32flat_start ) ;
*16.*(.text.putuint.constprop.0)
. = ( 0xf7fa9 - code32flat_start ) ;
*16.*(.text.__dprintf)
. = ( 0xf7fbd - code32flat_start ) ;
*16.*(.text.dump_regs)
. = ( 0xf8054 - code32flat_start ) ;
*16.*(.text.__debug_enter)
. = ( 0xf8076 - code32flat_start ) ;
*16.*(.text.__warn_invalid)
. = ( 0xf809c - code32flat_start ) ;
*16.*(.text.__set_invalid)
. = ( 0xf80b0 - code32flat_start ) ;
*16.*(.text.getComAddr)
. = ( 0xf8100 - code32flat_start ) ;
*16.*(.text.__set_code_invalid)
. = ( 0xf8126 - code32flat_start ) ;
*16.*(.text.__disk_ret)
. = ( 0xf8153 - code32flat_start ) ;
*16.*(.text.disk_1308)
. = ( 0xf828b - code32flat_start ) ;
*16.*(.text.__warn_unimplemented)
. = ( 0xf82b1 - code32flat_start ) ;
*16.*(.text.__set_code_unimplemented)
. = ( 0xf82d7 - code32flat_start ) ;
*16.*(.text.__disk_ret_unimplemented)
. = ( 0xf82ff - code32flat_start ) ;
*16.*(.text.__disk_stub)
. = ( 0xf8334 - code32flat_start ) ;
*16.*(.text.__warn_timeout)
. = ( 0xf834a - code32flat_start ) ;
*16.*(.text.floppy_disable_controller)
. = ( 0xf8364 - code32flat_start ) ;
*16.*(.text.timer_read)
. = ( 0xf83e2 - code32flat_start ) ;
*16.*(.text.timer_calc)
. = ( 0xf83fe - code32flat_start ) ;
*16.*(.text.timer_check)
. = ( 0xf841a - code32flat_start ) ;
*16.*(.text.udelay)
. = ( 0xf8460 - code32flat_start ) ;
*16.*(.text.i8042_wait_write)
. = ( 0xf84ab - code32flat_start ) ;
*16.*(.text.i8042_command)
. = ( 0xf8532 - code32flat_start ) ;
*16.*(.text.fill_generic_edd)
. = ( 0xf88f0 - code32flat_start ) ;
*16.*(.text.fill_edd)
. = ( 0xf8b26 - code32flat_start ) ;
*16.*(.text.__stack_hop_back.isra.0)
. = ( 0xf8b82 - code32flat_start ) ;
*16.*(.text.handle_12)
. = ( 0xf8ba7 - code32flat_start ) ;
*16.*(.text.handle_11)
. = ( 0xf8bcc - code32flat_start ) ;
*16.*(.text.handle_02)
. = ( 0xf8bd5 - code32flat_start ) ;
*16.*(.text.call16_helper)
. = ( 0xf8c15 - code32flat_start ) ;
*16.*(.text.__call32)
. = ( 0xf8c80 - code32flat_start ) ;
*16.*(.text._farcall16)
. = ( 0xf8ccb - code32flat_start ) ;
*16.*(.text.__call16_int)
. = ( 0xf8cde - code32flat_start ) ;
*16.*(.text.handle_75)
. = ( 0xf8d28 - code32flat_start ) ;
*16.*(.text.process_key)
. = ( 0xf9104 - code32flat_start ) ;
*16.*(.text.ramdisk_copy)
. = ( 0xf926d - code32flat_start ) ;
*16.*(.text.disk_1346.constprop.0)
. = ( 0xf9324 - code32flat_start ) ;
*16.*(.text.check_irqs)
. = ( 0xf9346 - code32flat_start ) ;
*16.*(.text.sercon_putchar)
. = ( 0xf93d1 - code32flat_start ) ;
*16.*(.text.sercon_term_clear_screen)
. = ( 0xf93fe - code32flat_start ) ;
*16.*(.text.sercon_term_cursor_goto)
. = ( 0xf949d - code32flat_start ) ;
*16.*(.text.sercon_set_attr)
. = ( 0xf9592 - code32flat_start ) ;
*16.*(.text.sercon_lazy_putchar)
. = ( 0xf9646 - code32flat_start ) ;
*16.*(.text.rtc_updating)
. = ( 0xf9693 - code32flat_start ) ;
*16.*(.text.ps2_sendbyte)
. = ( 0xf9744 - code32flat_start ) ;
*16.*(.text.set_leds)
. = ( 0xf97a3 - code32flat_start ) ;
*16.*(.text.ps2_mouse_command)
. = ( 0xf97f2 - code32flat_start ) ;
*16.*(.text.mouse_15c201)
. = ( 0xf983e - code32flat_start ) ;
*16.*(.text.handle_160a)
. = ( 0xf9874 - code32flat_start ) ;
*16.*(.text.floppy_wait_irq)
. = ( 0xf98f1 - code32flat_start ) ;
*16.*(.text.floppy_pio)
. = ( 0xf9a4f - code32flat_start ) ;
*16.*(.text.floppy_enable_controller)
. = ( 0xf9af0 - code32flat_start ) ;
*16.*(.text.floppy_drive_pio)
. = ( 0xf9b9b - code32flat_start ) ;
*16.*(.text.floppy_drive_readid.constprop.0)
. = ( 0xf9be1 - code32flat_start ) ;
*16.*(.text.floppy_read)
. = ( 0xf9c9a - code32flat_start ) ;
*16.*(.text.floppy_write)
. = ( 0xf9d53 - code32flat_start ) ;
*16.*(.text.floppy_format)
. = ( 0xf9ddb - code32flat_start ) ;
*16.*(.text.await_ide.constprop.0)
. = ( 0xf9e4c - code32flat_start ) ;
*16.*(.text.await_not_bsy)
. = ( 0xf9e5c - code32flat_start ) ;
*16.*(.text.ndelay_await_not_bsy)
. = ( 0xf9eac - code32flat_start ) ;
*16.*(.text.ata_wait_data)
. = ( 0xf9f15 - code32flat_start ) ;
*16.*(.text.send_cmd)
. = ( 0xfa041 - code32flat_start ) ;
*16.*(.text.ata_pio_transfer)
. = ( 0xfa19c - code32flat_start ) ;
*16.*(.text.ata_atapi_process_op)
. = ( 0xfa3cd - code32flat_start ) ;
*16.*(.text.ata_readwrite)
. = ( 0xfa79f - code32flat_start ) ;
*16.*(.text.process_op)
. = ( 0xfab7c - code32flat_start ) ;
*16.*(.text.disk_1300)
. = ( 0xfabbe - code32flat_start ) ;
*16.*(.text.disk_1305)
. = ( 0xfacec - code32flat_start ) ;
*16.*(.text.extended_access)
. = ( 0xfade6 - code32flat_start ) ;
*16.*(.text.disk_13)
. = ( 0xfb1a6 - code32flat_start ) ;
*16.*(.text.handle_legacy_disk)
. = ( 0xfb24d - code32flat_start ) ;
*16.*(.text.wait_irq)
. = ( 0xfb26d - code32flat_start ) ;
*16.*(.text.dequeue_key)
. = ( 0xfb349 - code32flat_start ) ;
*16.*(.text.handle_1553)
. = ( 0xfb4bb - code32flat_start ) ;
*16.*(.text.handle_40)
. = ( 0xfb4de - code32flat_start ) ;
*16.*(.text.handle_13)
. = ( 0xfb5b2 - code32flat_start ) ;
*16.*(.text.handle_76)
. = ( 0xfb5d4 - code32flat_start ) ;
*16.*(.text.invoke_mouse_handler)
. = ( 0xfb646 - code32flat_start ) ;
*16.*(.text.handle_16)
. = ( 0xfb769 - code32flat_start ) ;
*16.*(.text.handle_1589)
. = ( 0xfb80f - code32flat_start ) ;
*16.*(.text.handle_15)
. = ( 0xfc03d - code32flat_start ) ;
*16.*(.text.handle_14)
. = ( 0xfc26d - code32flat_start ) ;
*16.*(.text.handle_17)
. = ( 0xfc29c - code32flat_start ) ;
*16.*(.text.handle_08)
. = ( 0xfc4c3 - code32flat_start ) ;
*16.*(.text.handle_resume)
. = ( 0xfc58d - code32flat_start ) ;
*16.*(.text.handle_pnp)
. = ( 0xfc5d6 - code32flat_start ) ;
*16.*(.text.handle_pcibios)
. = ( 0xfc98b - code32flat_start ) ;
*16.*(.text.handle_apm)
. = ( 0xfc9a8 - code32flat_start ) ;
*16.*(.text.handle_hwpic1)
. = ( 0xfc9ca - code32flat_start ) ;
*16.*(.text.handle_hwpic2)
. = ( 0xfc9ee - code32flat_start ) ;
*16.*(.text.handle_74)
. = ( 0xfca84 - code32flat_start ) ;
*16.*(.text.handle_09)
. = ( 0xfcad9 - code32flat_start ) ;
*16.*(.text.asm.transition32)
. = ( 0xfcb27 - code32flat_start ) ;
*16.*(.text.asm.transition16)
. = ( 0xfcb75 - code32flat_start ) ;
*16.*(.text.asm.__farcall16)
. = ( 0xfcc02 - code32flat_start ) ;
*16.*(.text.asm.entry_smp)
. = ( 0xfcc32 - code32flat_start ) ;
*16.*(.text.asm.entry_resume)
. = ( 0xfcc47 - code32flat_start ) ;
*16.*(.text.asm.entry_pmm)
. = ( 0xfcca5 - code32flat_start ) ;
*16.*(.text.asm.entry_pnp_real)
. = ( 0xfcced - code32flat_start ) ;
*16.*(.text.asm.entry_apm16)
. = ( 0xfcd2e - code32flat_start ) ;
*16.*(.text.asm.entry_apm32)
. = ( 0xfcd60 - code32flat_start ) ;
*16.*(.text.asm.entry_pcibios32)
. = ( 0xfcd8e - code32flat_start ) ;
*16.*(.text.asm.entry_1589)
. = ( 0xfcdc8 - code32flat_start ) ;
*16.*(.text.asm.entry_sercon)
. = ( 0xfce0f - code32flat_start ) ;
*16.*(.text.asm.irqentry_extrastack)
. = ( 0xfce9c - code32flat_start ) ;
*16.*(.text.asm.irqentry_arg_extrastack)
. = ( 0xfcf3e - code32flat_start ) ;
*16.*(.text.asm.entry_13)
. = ( 0xfcf47 - code32flat_start ) ;
*16.*(.text.asm.entry_76)
. = ( 0xfcf50 - code32flat_start ) ;
*16.*(.text.asm.entry_74)
. = ( 0xfcf59 - code32flat_start ) ;
*16.*(.text.asm.entry_75)
. = ( 0xfcf62 - code32flat_start ) ;
*16.*(.text.asm.entry_hwpic1)
. = ( 0xfcf6b - code32flat_start ) ;
*16.*(.text.asm.entry_hwpic2)
. = ( 0xfcf74 - code32flat_start ) ;
*16.*(.text.asm.entry_19)
. = ( 0xfcf87 - code32flat_start ) ;
*16.*(.text.asm.entry_18)
. = ( 0xfcf9a - code32flat_start ) ;
_rodata16 = . ;
*16.*(.rodata)
. = ( 0xfd5a4 - code32flat_start ) ;
*16.*(.rodata.__func__.1)
. = ( 0xfd5b0 - code32flat_start ) ;
*16.*(.rodata.__func__.2)
. = ( 0xfd5c4 - code32flat_start ) ;
*16.*(.rodata.__func__.3)
. = ( 0xfd5d0 - code32flat_start ) ;
*16.*(.rodata.__func__.4)
. = ( 0xfd5dc - code32flat_start ) ;
*16.*(.rodata.__func__.5)
. = ( 0xfd5e8 - code32flat_start ) ;
*16.*(.rodata.__func__.6)
. = ( 0xfd5f8 - code32flat_start ) ;
*16.*(.rodata.__func__.9)
. = ( 0xfd604 - code32flat_start ) ;
*16.*(.rodata.__func__.10)
. = ( 0xfd610 - code32flat_start ) ;
*16.*(.rodata.__func__.12)
. = ( 0xfd620 - code32flat_start ) ;
*16.*(.rodata.__func__.13)
. = ( 0xfd634 - code32flat_start ) ;
*16.*(.rodata.__func__.14)
. = ( 0xfd640 - code32flat_start ) ;
*16.*(.rodata.__func__.15)
. = ( 0xfd650 - code32flat_start ) ;
*16.*(.rodata.__func__.16)
. = ( 0xfd660 - code32flat_start ) ;
*16.*(.rodata.__func__.17)
. = ( 0xfd670 - code32flat_start ) ;
*16.*(.rodata.__func__.18)
. = ( 0xfd680 - code32flat_start ) ;
*16.*(.rodata.__func__.19)
. = ( 0xfd690 - code32flat_start ) ;
*16.*(.rodata.__func__.20)
. = ( 0xfd6a0 - code32flat_start ) ;
*16.*(.rodata.__func__.22)
. = ( 0xfd6b0 - code32flat_start ) ;
*16.*(.rodata.__func__.23)
. = ( 0xfd6c0 - code32flat_start ) ;
*16.*(.rodata.__func__.24)
. = ( 0xfd6cc - code32flat_start ) ;
*16.*(.rodata.__func__.25)
. = ( 0xfd6dc - code32flat_start ) ;
*16.*(.rodata.__func__.26)
. = ( 0xfd6e8 - code32flat_start ) ;
*16.*(.rodata.__func__.27)
. = ( 0xfd6f4 - code32flat_start ) ;
*16.*(.rodata.__func__.28)
. = ( 0xfd700 - code32flat_start ) ;
*16.*(.rodata.__func__.29)
. = ( 0xfd70c - code32flat_start ) ;
*16.*(.rodata.__func__.30)
. = ( 0xfd718 - code32flat_start ) ;
*16.*(.rodata.__func__.31)
. = ( 0xfd724 - code32flat_start ) ;
*16.*(.rodata.__func__.32)
. = ( 0xfd730 - code32flat_start ) ;
*16.*(.rodata.__func__.33)
. = ( 0xfd73c - code32flat_start ) ;
*16.*(.rodata.__func__.34)
. = ( 0xfd748 - code32flat_start ) ;
*16.*(.rodata.__func__.35)
. = ( 0xfd754 - code32flat_start ) ;
*16.*(.rodata.__func__.36)
. = ( 0xfd760 - code32flat_start ) ;
*16.*(.rodata.__func__.37)
. = ( 0xfd76c - code32flat_start ) ;
*16.*(.rodata.__func__.38)
. = ( 0xfd778 - code32flat_start ) ;
*16.*(.rodata.__func__.39)
. = ( 0xfd784 - code32flat_start ) ;
*16.*(.rodata.__func__.40)
. = ( 0xfd794 - code32flat_start ) ;
*16.*(.rodata.__func__.41)
. = ( 0xfd7a4 - code32flat_start ) ;
*16.*(.rodata.__func__.42)
. = ( 0xfd7b4 - code32flat_start ) ;
*16.*(.rodata.__func__.43)
. = ( 0xfd7c0 - code32flat_start ) ;
*16.*(.rodata.__func__.44)
. = ( 0xfd7cc - code32flat_start ) ;
*16.*(.rodata.__func__.45)
. = ( 0xfd7d8 - code32flat_start ) ;
*16.*(.rodata.__func__.46)
. = ( 0xfd7e4 - code32flat_start ) ;
*16.*(.rodata.__func__.47)
. = ( 0xfd7f4 - code32flat_start ) ;
*16.*(.rodata.__func__.48)
. = ( 0xfd804 - code32flat_start ) ;
*16.*(.rodata.__func__.49)
. = ( 0xfd814 - code32flat_start ) ;
*16.*(.rodata.__func__.50)
. = ( 0xfd824 - code32flat_start ) ;
*16.*(.rodata.__func__.51)
. = ( 0xfd834 - code32flat_start ) ;
*16.*(.rodata.__func__.52)
. = ( 0xfd844 - code32flat_start ) ;
*16.*(.rodata.__func__.53)
. = ( 0xfd854 - code32flat_start ) ;
*16.*(.rodata.__func__.54)
. = ( 0xfd864 - code32flat_start ) ;
*16.*(.rodata.__func__.55)
. = ( 0xfd874 - code32flat_start ) ;
*16.*(.rodata.__func__.56)
. = ( 0xfd884 - code32flat_start ) ;
*16.*(.rodata.__func__.57)
. = ( 0xfd894 - code32flat_start ) ;
*16.*(.rodata.__func__.58)
. = ( 0xfd8a4 - code32flat_start ) ;
*16.*(.rodata.__func__.59)
. = ( 0xfd8b4 - code32flat_start ) ;
*16.*(.rodata.__func__.60)
. = ( 0xfd8c0 - code32flat_start ) ;
*16.*(.rodata.__func__.61)
. = ( 0xfd8cc - code32flat_start ) ;
*16.*(.rodata.__func__.62)
. = ( 0xfd8d8 - code32flat_start ) ;
*16.*(.rodata.__func__.63)
. = ( 0xfd8e4 - code32flat_start ) ;
*16.*(.rodata.__func__.64)
. = ( 0xfd8f0 - code32flat_start ) ;
*16.*(.rodata.__func__.65)
. = ( 0xfd8fc - code32flat_start ) ;
*16.*(.rodata.__func__.66)
. = ( 0xfd908 - code32flat_start ) ;
*16.*(.rodata.__func__.67)
. = ( 0xfd914 - code32flat_start ) ;
*16.*(.rodata.__func__.68)
. = ( 0xfd920 - code32flat_start ) ;
*16.*(.rodata.__func__.69)
. = ( 0xfd92c - code32flat_start ) ;
*16.*(.rodata.__func__.70)
. = ( 0xfd938 - code32flat_start ) ;
*16.*(.rodata.__func__.71)
. = ( 0xfd944 - code32flat_start ) ;
*16.*(.rodata.__func__.72)
. = ( 0xfd950 - code32flat_start ) ;
*16.*(.rodata.__func__.73)
. = ( 0xfd95c - code32flat_start ) ;
*16.*(.rodata.__func__.74)
. = ( 0xfd968 - code32flat_start ) ;
*16.*(.rodata.__func__.75)
. = ( 0xfd974 - code32flat_start ) ;
*16.*(.rodata.__func__.76)
. = ( 0xfd984 - code32flat_start ) ;
*16.*(.rodata.__func__.77)
. = ( 0xfd990 - code32flat_start ) ;
*16.*(.rodata.__func__.78)
. = ( 0xfd99c - code32flat_start ) ;
*16.*(.rodata.__func__.79)
. = ( 0xfd9a8 - code32flat_start ) ;
*16.*(.rodata.__func__.80)
. = ( 0xfd9b4 - code32flat_start ) ;
*16.*(.rodata.__func__.81)
. = ( 0xfd9c0 - code32flat_start ) ;
*16.*(.rodata.__func__.82)
. = ( 0xfd9cc - code32flat_start ) ;
*16.*(.rodata.__func__.83)
. = ( 0xfd9d8 - code32flat_start ) ;
*16.*(.rodata.__func__.84)
. = ( 0xfd9e4 - code32flat_start ) ;
*16.*(.rodata.__func__.85)
. = ( 0xfd9f0 - code32flat_start ) ;
*16.*(.rodata.__func__.86)
. = ( 0xfd9fc - code32flat_start ) ;
*16.*(.rodata.__func__.87)
. = ( 0xfda08 - code32flat_start ) ;
*16.*(.rodata.__func__.88)
. = ( 0xfda18 - code32flat_start ) ;
*16.*(.rodata.__func__.89)
. = ( 0xfda24 - code32flat_start ) ;
*16.*(.rodata.__func__.90)
. = ( 0xfda30 - code32flat_start ) ;
*16.*(.rodata.__func__.91)
. = ( 0xfda44 - code32flat_start ) ;
*16.*(.rodata.__func__.92)
. = ( 0xfda50 - code32flat_start ) ;
*16.*(.rodata.__func__.95)
. = ( 0xfda5c - code32flat_start ) ;
*16.*(.rodata.__func__.96)
. = ( 0xfda68 - code32flat_start ) ;
*16.*(.rodata.__func__.97)
. = ( 0xfda74 - code32flat_start ) ;
*16.*(.rodata.__func__.98)
. = ( 0xfda80 - code32flat_start ) ;
*16.*(.rodata.__func__.99)
. = ( 0xfdaa0 - code32flat_start ) ;
*16.*(.data16../src/cp437.c.11)
. = ( 0xfdca0 - code32flat_start ) ;
*16.*(.data16../src/sercon.c.554)
. = ( 0xfdd50 - code32flat_start ) ;
*16.*(.data16../src/sercon.c.70)
. = ( 0xfdd58 - code32flat_start ) ;
*16.*(.data16../src/kbd.c.374)
. = ( 0xfdd60 - code32flat_start ) ;
*16.*(.data16../src/kbd.c.371)
. = ( 0xfdd80 - code32flat_start ) ;
*16.*(.data16../src/kbd.c.279)
. = ( 0xfe048 - code32flat_start ) ;
*16.*(.data16../src/mouse.c.106)
. = ( 0xfe05b - code32flat_start ) ;
*16.*(.fixedaddr.0xe05b)
. = ( 0xfe079 - code32flat_start ) ;
*16.*(.text.cdemu_read)
. = ( 0xfe2b8 - code32flat_start ) ;
*16.*(.text.handle_05)
. = ( 0xfe2c3 - code32flat_start ) ;
*16.*(.fixedaddr.0xe2c3)
. = ( 0xfe2e8 - code32flat_start ) ;
*16.*(.text.sercon_lazy_flush)
. = ( 0xfe3f2 - code32flat_start ) ;
*16.*(.text.set_code_success)
. = ( 0xfe3fe - code32flat_start ) ;
*16.*(.fixedaddr.0xe3fe)
. = ( 0xfe401 - code32flat_start ) ;
*32flat.*(.fixedaddr.0xe401)
. = ( 0xfe411 - code32flat_start ) ;
*16.*(.text.handle_1a)
. = ( 0xfe6ea - code32flat_start ) ;
*16.*(.text.asm.irq_trampoline_0x05)
. = ( 0xfe6ed - code32flat_start ) ;
*16.*(.text.asm.irq_trampoline_0x02)
. = ( 0xfe6f2 - code32flat_start ) ;
*16.*(.fixedaddr.0xe6f2)
. = ( 0xfe6f5 - code32flat_start ) ;
*32flat.*(.fixedaddr.0xe6f5)
. = ( 0xfe6ff - code32flat_start ) ;
*16.*(.text.sercon_cursor_pos_set)
. = ( 0xfe729 - code32flat_start ) ;
*32flat.*(.fixedaddr.0xe729)
. = ( 0xfe739 - code32flat_start ) ;
*16.*(.fixedaddr.0xe739)
. = ( 0xfe742 - code32flat_start ) ;
*16.*(.text.ps2_recvbyte)
. = ( 0xfe827 - code32flat_start ) ;
*16.*(.text.asm.irq_trampoline_0x15)
. = ( 0xfe82a - code32flat_start ) ;
*16.*(.text.asm.irq_trampoline_0x13)
. = ( 0xfe82e - code32flat_start ) ;
*16.*(.fixedaddr.0xe82e)
. = ( 0xfe837 - code32flat_start ) ;
*16.*(.text.floppy_dma_cmd)
. = ( 0xfe971 - code32flat_start ) ;
*16.*(.text.panic.constprop.0)
. = ( 0xfe987 - code32flat_start ) ;
*16.*(.fixedaddr.0xe987)
. = ( 0xfe990 - code32flat_start ) ;
*16.*(.text.ps2_command)
. = ( 0xfec4d - code32flat_start ) ;
*16.*(.text.qemu_debug_putc)
. = ( 0xfec59 - code32flat_start ) ;
*16.*(.fixedaddr.0xec59)
. = ( 0xfec62 - code32flat_start ) ;
*16.*(.text.bvprintf.constprop.0)
. = ( 0xfef57 - code32flat_start ) ;
*16.*(.fixedaddr.0xef57)
. = ( 0xfef60 - code32flat_start ) ;
*16.*(.text.disk_1315)
. = ( 0xfefc7 - code32flat_start ) ;
*32flat.*(.fixedaddr.0xefc7)
. = ( 0xfefd2 - code32flat_start ) ;
*16.*(.fixedaddr.0xefd2)
. = ( 0xfefdb - code32flat_start ) ;
*16.*(.text.sercon_print_utf8)
. = ( 0xff045 - code32flat_start ) ;
*16.*(.fixedaddr.0xf045)
. = ( 0xff046 - code32flat_start ) ;
*16.*(.text.asm.entry_bios32)
. = ( 0xff065 - code32flat_start ) ;
*16.*(.fixedaddr.0xf065)
. = ( 0xff066 - code32flat_start ) ;
*16.*(.text.asm.entry_pcibios16)
. = ( 0xff0a0 - code32flat_start ) ;
*16.*(.text.asm.irq_trampoline_0x19)
. = ( 0xff0a4 - code32flat_start ) ;
*32flat.*(.fixedaddr.0xf0a4)
. = ( 0xff0fc - code32flat_start ) ;
*16.*(.text.handle_sercon)
. = ( 0xff527 - code32flat_start ) ;
*16.*(.text.floppy_prep)
. = ( 0xff830 - code32flat_start ) ;
*16.*(.text.memset.constprop.0.isra.0)
. = ( 0xff841 - code32flat_start ) ;
*16.*(.fixedaddr.0xf841)
. = ( 0xff84a - code32flat_start ) ;
*16.*(.text.asm.irq_trampoline_0x1c)
. = ( 0xff84d - code32flat_start ) ;
*16.*(.fixedaddr.0xf84d)
. = ( 0xff856 - code32flat_start ) ;
*16.*(.text.asm.irq_trampoline_0x1b)
. = ( 0xff859 - code32flat_start ) ;
*16.*(.fixedaddr.0xf859)
. = ( 0xff869 - code32flat_start ) ;
*16.*(.text.basic_access)
. = ( 0xff9dc - code32flat_start ) ;
*16.*(.text.call32_prep)
. = ( 0xffa69 - code32flat_start ) ;
*16.*(.text.asm.irq_trampoline_0x10)
. = ( 0xffa6e - code32flat_start ) ;
*32flat.*(.fixedaddr.0xfa6e)
. = ( 0xffe6e - code32flat_start ) ;
*16.*(.fixedaddr.0xfe6e)
. = ( 0xffe7e - code32flat_start ) ;
*16.*(.text.handle_0e)
. = ( 0xffea5 - code32flat_start ) ;
*16.*(.fixedaddr.0xfea5)
. = ( 0xffeae - code32flat_start ) ;
*16.*(.text.disk_1310)
. = ( 0xffef3 - code32flat_start ) ;
*32flat.*(.fixedaddr.0xfef3)
. = ( 0xfff00 - code32flat_start ) ;
*16.*(.text.sercon_lazy_lf)
. = ( 0xfff50 - code32flat_start ) ;
*16.*(.text.asm.irq_trampoline_0x18)
. = ( 0xfff53 - code32flat_start ) ;
*16.*(.fixedaddr.0xff53)
. = ( 0xfff54 - code32flat_start ) ;
*16.*(.fixedaddr.0xff54)
. = ( 0xfff5d - code32flat_start ) ;
*16.*(.text.pci_next)
. = ( 0xffff0 - code32flat_start ) ;
*16.*(.fixedaddr.0xfff0)
. = ( 0xffff5 - code32flat_start ) ;
*32flat.*(.fixedaddr.0xfff5)
. = ( 0xffffe - code32flat_start ) ;
*32flat.*(.fixedaddr.0xfffe)
. = ( 0xfffff - code32flat_start ) ;
*32flat.*(.fixedaddr.0xffff)

        code32flat_end = ABSOLUTE(.) ;
    } :text


        /* Discard regular data sections to force a link error if
         * code attempts to access data not marked with VAR16 (or other
         * appropriate macro)
         */
        /DISCARD/ : {
                *(.text*) *(.data*) *(.bss*) *(.rodata*)
                *(COMMON) *(.discard*) *(.eh_frame) *(.note*)
                }
}

ENTRY(reset_vector)
PHDRS
{
        text PT_LOAD AT ( code32flat_start ) ;
}
